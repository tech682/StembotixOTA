/*
  StembotixOTA example - Blockzie App Realtime
  --------------------------------------------
  Blockzie realtime (WiFi) firmware with OTA updates.

  - Normal mode: joins WiFi and runs the Blockzie HTTP server, so the
    Blockzie app can control the board live (/connect, /disconnect, /control).
  - Hold BOOT 3 s -> OTA mode: Blockzie server stops, the board waits for
    new firmware from https://ota.blockzieai.com/dashboard
  - Hold BOOT 3 s again in OTA mode -> WiFi setup hotspot STEMbotix-Setup-XXXX.
    The WiFi saved there is used by both Blockzie and OTA.

  Set DEFAULT_SSID / DEFAULT_PASS below, or leave them and use the setup hotspot.

  Extra libraries needed (Library Manager):
    ESP32Servo, DHT sensor library, TM1637 (TM1637Display), Adafruit TCS34725,
    Adafruit NeoPixel, LiquidCrystal I2C, Adafruit GFX, Adafruit SSD1306
*/
// generated by Blockzie  +  StembotixOTA (hold BOOT 3 s for OTA mode)
#include <Arduino.h>
#include <StembotixOTA.h>
#include <Preferences.h>

#include <WiFi.h>
#include <WebServer.h>
#include <ESP32Servo.h>
#include <DHT.h>
#include <TM1637Display.h>
#ifndef SEG_DP
#define SEG_DP 0b10000000   // decimal point segment (missing in some TM1637Display versions)
#endif
#include <Adafruit_TCS34725.h>
#include <SPI.h>
#include <Adafruit_NeoPixel.h>
#include <Wire.h>
#include <LiquidCrystal_I2C.h>
#include <Adafruit_GFX.h>
#include <Adafruit_SSD1306.h>
#include <stdint.h>
#if defined(ARDUINO_ARCH_ESP32)
#include "soc/soc.h"
#include "soc/rtc_cntl_reg.h"
#endif
struct RgbLedEntry;


// ---------- WiFi for Blockzie + OTA ----------
// Default WiFi: used only if no WiFi was saved on the STEMbotix-Setup hotspot.
const char* DEFAULT_SSID = "YOUR_WIFI_NAME";
const char* DEFAULT_PASS = "YOUR_WIFI_PASSWORD";

const char* ssid = DEFAULT_SSID;       // what Blockzie connects with (set by loadWiFiCredentials)
const char* password = DEFAULT_PASS;
String savedSsid, savedPass;

// Use the WiFi saved by the OTA library's setup hotspot, so Blockzie and OTA
// always use the same network. Falls back to DEFAULT_SSID / DEFAULT_PASS.
void loadWiFiCredentials() {
  Preferences p;
  if (p.begin("ota", true)) {            // same storage the OTA library uses
    savedSsid = p.getString("ssid", "");
    savedPass = p.getString("pass", "");
    p.end();
  }
  if (savedSsid.length()) {
    ssid = savedSsid.c_str();
    password = savedPass.c_str();
    Serial.printf("Using WiFi saved on the setup hotspot: %s\n", ssid);
  } else {
    Serial.printf("Using default WiFi: %s\n", ssid);
  }
}

WebServer server(80);

// Runs once when OTA mode starts: stop the Blockzie server so port 80 is free
// (the WiFi setup hotspot needs it) and Blockzie commands stop arriving.
void stopBlockzie() {
  server.stop();
}
Servo __blockly_servo__;

// DHT Sensors (slots 0-4 so Blockly sensor 1..4 all work)
DHT* dhtSensors[5] = {nullptr, nullptr, nullptr, nullptr, nullptr};
uint8_t dhtPins[5] = {255, 255, 255, 255, 255};
uint8_t dhtTypes[5] = {0, 0, 0, 0, 0};
float dhtLastTemp[5] = {NAN, NAN, NAN, NAN, NAN};
float dhtLastHum[5] = {NAN, NAN, NAN, NAN, NAN};
unsigned long dhtLastOkMs[5] = {0, 0, 0, 0, 0};

bool dhtSample(uint8_t pin, uint8_t type, float* tempC, float* hum) {
  uint8_t data[5] = {0, 0, 0, 0, 0};
  pinMode(pin, OUTPUT);
  digitalWrite(pin, LOW);
  delay(type == 11 ? 20 : 2);
  digitalWrite(pin, HIGH);
  delayMicroseconds(30);
  pinMode(pin, INPUT_PULLUP);
  if (pulseIn(pin, HIGH, 1000) == 0) return false;
  for (int i = 0; i < 40; i++) {
    unsigned long dur = pulseIn(pin, HIGH, 1000);
    if (dur == 0) return false;
    data[i / 8] <<= 1;
    if (dur > 40) data[i / 8] |= 1;
  }
  if (data[4] != (uint8_t)(data[0] + data[1] + data[2] + data[3])) return false;
  if (type == 11) {
    *hum = data[0];
    *tempC = data[2];
  } else {
    *hum = ((data[0] << 8) | data[1]) * 0.1f;
    *tempC = (((data[2] & 0x7F) << 8) | data[3]) * 0.1f;
    if (data[2] & 0x80) *tempC = -*tempC;
  }
  return true;
}

bool dhtReadSlot(int no, float* tempC, float* hum) {
  if (no < 0 || no > 4 || dhtPins[no] == 255) return false;
  for (int attempt = 0; attempt < 3; attempt++) {
    if (dhtSample(dhtPins[no], dhtTypes[no], tempC, hum)) {
      dhtLastTemp[no] = *tempC;
      dhtLastHum[no] = *hum;
      dhtLastOkMs[no] = millis();
      return true;
    }
    delay(60);
  }
  if (!isnan(dhtLastTemp[no]) && (millis() - dhtLastOkMs[no]) < 5000UL) {
    *tempC = dhtLastTemp[no];
    *hum = dhtLastHum[no];
    return true;
  }
  return false;
}

int dhtParseModel(const char* s) {
  if (!s || !s[0]) return 11;
  if (s[0] >= '0' && s[0] <= '9') return atoi(s);
  if (strstr(s, "22") || strstr(s, "AM2302")) return 22;
  if (strstr(s, "21") || strstr(s, "AM2301")) return 21;
  return 11;
}

// TM1637 Display
TM1637Display* tm1637Display = nullptr;
uint8_t tm1637Segments[4] = {0, 0, 0, 0};
uint8_t tm1637Dots = 0;
int tm1637LastNumber = 0;
int tm1637LastLength = 4;
int tm1637LastPosition = 0;
bool tm1637LastLeadingZeros = false;
bool tm1637HasLastNumber = false;
// 7-segment segment map for digits and common letters (A,B,C... O,P,E,n etc.)
uint8_t tm1637SegmentForChar(char c) {
  if (c >= '0' && c <= '9') return tm1637Display->encodeDigit(c - '0');
  switch ((char)toupper((int)c)) {
    case 'A': return 0x77; case 'B': return 0x7C; case 'C': return 0x39;
    case 'D': return 0x5E; case 'E': return 0x79; case 'F': return 0x71;
    case 'G': return 0x3D; case 'H': return 0x76; case 'I': return 0x30;
    case 'J': return 0x1E; case 'L': return 0x38; case 'N': return 0x54;
    case 'O': return 0x3F; case 'P': return 0x73; case 'Q': return 0x67;
    case 'R': return 0x50; case 'S': return 0x6D; case 'T': return 0x78;
    case 'U': return 0x3E; case 'Y': return 0x6E; case 'Z': return 0x5B;
    default: return 0x00;
  }
  return 0x00;
}

uint8_t tm1637ParseSegmentExpr(String expression) {
  expression.trim();
  if (expression.indexOf("SEG_") >= 0) {
    uint8_t value = 0;
    if (expression.indexOf("SEG_A") >= 0) value |= SEG_A;
    if (expression.indexOf("SEG_B") >= 0) value |= SEG_B;
    if (expression.indexOf("SEG_C") >= 0) value |= SEG_C;
    if (expression.indexOf("SEG_D") >= 0) value |= SEG_D;
    if (expression.indexOf("SEG_E") >= 0) value |= SEG_E;
    if (expression.indexOf("SEG_F") >= 0) value |= SEG_F;
    if (expression.indexOf("SEG_G") >= 0) value |= SEG_G;
    if (expression.indexOf("SEG_DP") >= 0) value |= SEG_DP;
    return value;
  }
  return (uint8_t)strtol(expression.c_str(), nullptr, 0);
}

// TCS34725 Color Sensor (I2C)
Adafruit_TCS34725* tcs34725 = nullptr;
uint16_t tcs34725Color[4] = {0, 0, 0, 0}; // R, G, B, C

void tcs34725Update() {
  if (tcs34725 != nullptr) {
    tcs34725->getRawData(
      &tcs34725Color[0], &tcs34725Color[1],
      &tcs34725Color[2], &tcs34725Color[3]
    );
  }
}

String tcs34725DetectColour() {
  tcs34725Update();
  uint16_t c = tcs34725Color[3];
  if (c < 50) return "BLACK";
  float r = (float)tcs34725Color[0] / c * 255.0f;
  float g = (float)tcs34725Color[1] / c * 255.0f;
  float b = (float)tcs34725Color[2] / c * 255.0f;
  if (r > 180 && g > 180 && b > 180) return "WHITE";
  if (r > 120 && g > 100 && b < 100 && (r - b) > 40 && (g - b) > 30) return "YELLOW";
  if (r >= g && r >= b && (r - g) > 15) return "RED";
  if (g >= r && g >= b && (g - r) > 15) return "GREEN";
  if (b >= r && b >= g && (b - r) > 15) return "BLUE";
  if (g >= r && g >= b) return "GREEN";
  if (r >= g && r >= b) return "RED";
  return "BLUE";
}

int tcs3200S0 = -1, tcs3200S1 = -1, tcs3200S2 = -1, tcs3200S3 = -1, tcs3200Out = -1, tcs3200Oe = -1;
unsigned long tcs3200White[3] = {1, 1, 1};
unsigned long tcs3200Black[3] = {1, 1, 1};
unsigned long tcs3200Last[3] = {0, 0, 0};
bool tcs3200Ready = false;

unsigned long tcs3200Pulse(bool s2, bool s3) {
  if (tcs3200Out < 0) return 0;
  digitalWrite(tcs3200S2, s2 ? HIGH : LOW);
  digitalWrite(tcs3200S3, s3 ? HIGH : LOW);
  delay(8);
  return pulseIn(tcs3200Out, LOW, 80000UL);
}

void tcs3200MeasureRaw() {
  tcs3200Last[0] = tcs3200Pulse(false, false);
  tcs3200Last[1] = tcs3200Pulse(true, true);
  tcs3200Last[2] = tcs3200Pulse(false, true);
}

int tcs3200MapChannel(int i) {
  unsigned long lo = tcs3200White[i];
  unsigned long hi = tcs3200Black[i];
  unsigned long v = tcs3200Last[i];
  if (hi == lo) return 0;
  if (hi < lo) { unsigned long tmp = hi; hi = lo; lo = tmp; }
  long mapped = map((long)v, (long)lo, (long)hi, 255, 0);
  return (int)constrain(mapped, 0, 255);
}

// SSD1306 OLED
Adafruit_SSD1306* oledDisplay = nullptr;
bool oledReady = false;

bool oledDoInit(int width, int height, int address, int powerMode) {
  if (oledDisplay != nullptr) {
    delete oledDisplay;
    oledDisplay = nullptr;
  }
  oledDisplay = new Adafruit_SSD1306(width, height, &Wire, -1, 100000UL, 100000UL);
  Wire.begin();
  Wire.setClock(100000L);
  delay(100);
  bool ok = oledDisplay->begin(powerMode, address);
  if (!ok) ok = oledDisplay->begin(powerMode, address == 0x3D ? 0x3C : 0x3D);
  if (!ok) {
    delete oledDisplay;
    oledDisplay = nullptr;
    oledReady = false;
    return false;
  }
  oledDisplay->clearDisplay();
  oledDisplay->setTextSize(1);
  oledDisplay->setTextColor(SSD1306_WHITE);
  oledDisplay->cp437(true);
  oledDisplay->setCursor(0, 0);
  oledDisplay->display();
  oledReady = true;
  return true;
}

void oledRefresh() {
  if (oledReady && oledDisplay != nullptr) oledDisplay->display();
}

uint16_t oledColorFromText(const char* value) {
  if (!strcasecmp(value, "light") || !strcasecmp(value, "white") ||
      !strcasecmp(value, "SSD1306_WHITE") || !strcmp(value, "1")) {
    return SSD1306_WHITE;
  }
  if (!strcasecmp(value, "inverse") || !strcasecmp(value, "SSD1306_INVERSE") ||
      !strcmp(value, "2")) {
    return SSD1306_INVERSE;
  }
  return SSD1306_BLACK;
}

bool oledSetFontByName(const char* font) {
  if (oledDisplay == nullptr) return false;
  oledDisplay->setFont();
  return true;
}

// Ultrasonic Sensor
int ultrasonicTrig = -1;
int ultrasonicEcho = -1;

// Matrix 8x8 (MAX7219) - Simple SPI implementation
int matrix8x8_cs_pin = -1;
uint8_t matrix8x8_buffer[8] = {0};  // 8 rows, each row is 8 bits

// MAX7219 register addresses
#define MAX7219_REG_NOOP        0x00
#define MAX7219_REG_DIGIT0      0x01
#define MAX7219_REG_DIGIT1      0x02
#define MAX7219_REG_DIGIT2      0x03
#define MAX7219_REG_DIGIT3      0x04
#define MAX7219_REG_DIGIT4      0x05
#define MAX7219_REG_DIGIT5      0x06
#define MAX7219_REG_DIGIT6      0x07
#define MAX7219_REG_DIGIT7      0x08
#define MAX7219_REG_DECODEMODE  0x09
#define MAX7219_REG_INTENSITY   0x0A
#define MAX7219_REG_SCANLIMIT   0x0B
#define MAX7219_REG_SHUTDOWN    0x0C
#define MAX7219_REG_DISPLAYTEST 0x0F

// Helper function to send data to MAX7219
void max7219_send(uint8_t reg, uint8_t data) {
  digitalWrite(matrix8x8_cs_pin, LOW);
  SPI.transfer(reg);
  SPI.transfer(data);
  digitalWrite(matrix8x8_cs_pin, HIGH);
}

// LED Matrix (WS2812/NeoPixel 5x7 = 35 LEDs)
Adafruit_NeoPixel* ledMatrixStrip = nullptr;
#define LEDMATRIX_DEFAULT_PIN 4
#define LEDMATRIX_ROWS 7
#define LEDMATRIX_COLS 5
#define LEDMATRIX_LEDS 35

// Helper function to set pixel in 5x7 matrix
void setMatrixPixel(int x, int y, uint32_t color) {
  if (ledMatrixStrip != nullptr && x >= 0 && x < LEDMATRIX_COLS && y >= 0 && y < LEDMATRIX_ROWS) {
    // Row-major order: y * COLS + x
    int idx = y * LEDMATRIX_COLS + x;
    ledMatrixStrip->setPixelColor(idx, color);
  }
}

const uint8_t matrixCharacters[38][5] PROGMEM = {
  {0x3E,0x51,0x49,0x45,0x3E},{0x00,0x42,0x7F,0x40,0x00},
  {0x62,0x51,0x49,0x49,0x46},{0x22,0x41,0x49,0x49,0x36},
  {0x18,0x14,0x12,0x7F,0x10},{0x2F,0x49,0x49,0x49,0x31},
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  {0x1C,0x3E,0x7C,0x3E,0x1C},{0x20,0x4C,0x40,0x4C,0x20}
};

void matrixShowCharacter(char character, uint32_t colour) {
  if (ledMatrixStrip == nullptr) return;
  int characterIndex = -1;
  if (character >= '0' && character <= '9') characterIndex = character - '0';
  else if (character >= 'A' && character <= 'Z') characterIndex = 10 + character - 'A';
  else if (character == '*') characterIndex = 36;
  else if (character == ':') characterIndex = 37;
  if (characterIndex < 0) return;
  ledMatrixStrip->clear();
  for (int x = 0; x < 5; x++) {
    uint8_t column = pgm_read_byte(&matrixCharacters[characterIndex][x]);
    for (int y = 0; y < 7; y++) {
      if (column & (1 << y)) ledMatrixStrip->setPixelColor(y * 5 + x, colour);
    }
  }
  ledMatrixStrip->show();
}

// Stepper Motor
int stepperDirPin = -1;
int stepperStepPin = -1;
int stepperStepsPerRev = 200;
bool stepperInitialized = false;

// 1602 LCD (I2C) — commands: LCD_INIT_I2C, LCD_CURSOR, LCD_PRINT, LCD_CLEAR, LCD_BACKLIGHT, LCD_ACTION
LiquidCrystal_I2C* lcdI2c = nullptr;
bool lcdReady = false;
int lcdI2cAddrStored = 39;
int lcdColsStored = 16;
int lcdRowsStored = 2;
int lcdSdaStored = 21;
int lcdSclStored = 22;

bool lcdDoInit(int addr, int cols, int rows, int sda, int scl) {
  if (lcdI2c != nullptr) {
    delete lcdI2c;
    lcdI2c = nullptr;
  }
  lcdI2cAddrStored = addr;
  lcdColsStored = cols;
  lcdRowsStored = rows;
  lcdSdaStored = sda;
  lcdSclStored = scl;
#if defined(ARDUINO_ARCH_ESP32)
  Wire.begin(sda, scl);
#else
  Wire.begin();
#endif
  lcdI2c = new LiquidCrystal_I2C(addr, cols, rows);
  lcdI2c->init();
  lcdI2c->backlight();
  lcdI2c->display();
  lcdI2c->clear();
  lcdReady = true;
  return true;
}

bool lcdEnsureReady() {
  if (lcdReady && lcdI2c != nullptr) return true;
  return lcdDoInit(lcdI2cAddrStored, lcdColsStored, lcdRowsStored, lcdSdaStored, lcdSclStored);
}

// RGB LED (WS2812/NeoPixel, one LED per data pin) — RGBLED_INIT, RGBLED_SET, RGBLED_OFF
#define RGBLED_MAX_STRIPS 8
struct RgbLedEntry {
  int pin;
  uint8_t r, g, b;
  Adafruit_NeoPixel* strip;
};
RgbLedEntry rgbLedStrips[RGBLED_MAX_STRIPS];
int rgbLedStripCount = 0;
int rgbLedPortPin[RGBLED_MAX_STRIPS + 1] = {-1,-1,-1,-1,-1,-1,-1,-1,-1};

int rgbLedResolvePin(int portOrPin) {
  if (portOrPin >= 1 && portOrPin <= RGBLED_MAX_STRIPS && rgbLedPortPin[portOrPin] >= 0) {
    return rgbLedPortPin[portOrPin];
  }
  return portOrPin;
}

RgbLedEntry* rgbLedGetEntry(int portOrPin) {
  int pin = rgbLedResolvePin(portOrPin);
  for (int i = 0; i < rgbLedStripCount; i++) {
    if (rgbLedStrips[i].pin == pin) return &rgbLedStrips[i];
  }
  if (rgbLedStripCount >= RGBLED_MAX_STRIPS) return nullptr;
  RgbLedEntry* item = &rgbLedStrips[rgbLedStripCount++];
  item->pin = pin;
  item->r = item->g = item->b = 0;
  item->strip = new Adafruit_NeoPixel(1, pin, NEO_GRB + NEO_KHZ800);
  item->strip->begin();
  item->strip->setBrightness(255);
  item->strip->clear();
  item->strip->show();
  return item;
}

Adafruit_NeoPixel* rgbLedGetStrip(int pin) {
  RgbLedEntry* item = rgbLedGetEntry(pin);
  return item == nullptr ? nullptr : item->strip;
}

void rgbLedApply(RgbLedEntry* item) {
  if (item == nullptr || item->strip == nullptr) return;
  item->strip->setPixelColor(0, item->strip->Color(item->r, item->g, item->b));
  item->strip->show();
}

int parseWifiPin(const char* pinText) {
  if (pinText == NULL || pinText[0] == 0) return -1;
  if ((pinText[0] == 'I' || pinText[0] == 'i') && (pinText[1] == 'O' || pinText[1] == 'o')) return atoi(pinText + 2);
  if ((pinText[0] == 'A' || pinText[0] == 'a' || pinText[0] == 'D' || pinText[0] == 'd') &&
      pinText[1] >= '0' && pinText[1] <= '9') return atoi(pinText + 1);
  return atoi(pinText);
}

#if defined(ARDUINO_ARCH_ESP32)
#define WIFI_ADC_MAX 4095.0f
#define WIFI_ADC_VREF 3.3f
#else
#define WIFI_ADC_MAX 1023.0f
#define WIFI_ADC_VREF 5.0f
#endif

int voltagePin = -1;
float voltageReference = WIFI_ADC_VREF;
int currentPin = -1;
float currentSensitivity = 0.185f;
float currentZeroPoint = 2.5f;

float currentSensitivityFrom(const char* text) {
  String s = String(text);
  s.toUpperCase();
  if (s.indexOf("ACS") >= 0 && s.indexOf("30") >= 0) return 0.066f;
  if (s.indexOf("ACS") >= 0 && s.indexOf("20") >= 0) return 0.100f;
  if (s.indexOf("ACS") >= 0 && s.indexOf("5") >= 0) return 0.185f;
  float value = s.toFloat();
  if (value > 1.0f) value = value / 1000.0f;
  return value > 0 ? value : 0.185f;
}

float readVoltageVout() {
  if (voltagePin < 0) return 0;
  long sum = 0;
  for (int i = 0; i < 8; i++) {
    sum += analogRead(voltagePin);
    delay(2);
  }
  return (sum / 8.0f) * (voltageReference / WIFI_ADC_MAX);
}

float readCurrentAmps() {
  if (currentPin < 0) return 0;
  long sum = 0;
  for (int i = 0; i < 100; i++) {
    sum += analogRead(currentPin);
    delay(2);
  }
  float voltage = (sum / 100.0f) * (WIFI_ADC_VREF / WIFI_ADC_MAX);
  return (voltage - currentZeroPoint) / currentSensitivity;
}

// Rotary encoder — ENCODER_INIT, ENCODER_GET_COUNT, ENCODER_RESET, ENCODER_GET_DIRECTION, ENCODER_GET_SPEED
#define ENC_STEPS_PER_CLICK 4
int encClkPin = -1, encDtPin = -1, encSwPin = -1;
volatile long encCount = 0;
volatile int8_t encDir = 0;
volatile uint8_t encPrevState = 0;
volatile int8_t encAcc = 0;
volatile uint32_t encLastStepUs = 0;
volatile int32_t encSpeedMilliSps = 0;
bool encInitialized = false;
bool encButtonListening = false;
bool encButtonPrevious = false;

uint8_t encReadState() {
  uint8_t clk = (uint8_t)digitalRead(encClkPin);
  uint8_t dt = (uint8_t)digitalRead(encDtPin);
  return (uint8_t)((clk << 1) | dt);
}

void encApplyDelta(int8_t delta) {
  if (delta == 0) return;
  encAcc += delta;
  if (encAcc >= 4) {
    uint32_t now = micros();
    if (encLastStepUs != 0) {
      uint32_t dt = (uint32_t)(now - encLastStepUs);
      if (dt > 80UL && dt < 400000UL) {
        int32_t inst = (int32_t)(1000000000LL / (int64_t)dt);
        encSpeedMilliSps = (int32_t)(((int64_t)encSpeedMilliSps * 6 + (int64_t)inst * 4) / 10);
      }
    }
    encLastStepUs = now;
    encCount++;
    encDir = 1;
    encAcc = 0;
  } else if (encAcc <= -4) {
    uint32_t now = micros();
    if (encLastStepUs != 0) {
      uint32_t dt = (uint32_t)(now - encLastStepUs);
      if (dt > 80UL && dt < 400000UL) {
        int32_t inst = -(int32_t)(1000000000LL / (int64_t)dt);
        encSpeedMilliSps = (int32_t)(((int64_t)encSpeedMilliSps * 6 + (int64_t)inst * 4) / 10);
      }
    }
    encLastStepUs = now;
    encCount--;
    encDir = -1;
    encAcc = 0;
  }
}

void IRAM_ATTR encISR() {
  const uint8_t state = encReadState();
  const uint8_t idx = (uint8_t)((encPrevState << 2) | state);
  static const int8_t tbl[16] = {
    0, -1,  1,  0,
    1,  0,  0, -1,
   -1,  0,  0,  1,
    0,  1, -1,  0
  };
  encApplyDelta(tbl[idx]);
  encPrevState = state;
}

void encPoll() {
  if (!encInitialized) return;
  const uint8_t state = encReadState();
  const uint8_t idx = (uint8_t)((encPrevState << 2) | state);
  static const int8_t tbl[16] = {
    0, -1,  1,  0,
    1,  0,  0, -1,
   -1,  0,  0,  1,
    0,  1, -1,  0
  };
  encApplyDelta(tbl[idx]);
  encPrevState = state;
}

long encGetCount() {
  encPoll();
  noInterrupts();
  long c = encCount;
  interrupts();
  return c;
}

// Blockzie runtime divides by 4 — return step count (detents * 4), not detents
long encGetCountForApp() {
  long detents = encGetCount();
  return detents * ENC_STEPS_PER_CLICK;
}

String encGetDirectionStr() {
  encPoll();
  noInterrupts();
  int8_t d = encDir;
  interrupts();
  uint32_t now = micros();
  if (encLastStepUs == 0 || (uint32_t)(now - encLastStepUs) > 250000UL) return "stopped";
  if (d > 0) return "clockwise";
  if (d < 0) return "anticlockwise";
  return "stopped";
}

float encGetSpeed() {
  encPoll();
  uint32_t now = micros();
  noInterrupts();
  uint32_t last = encLastStepUs;
  int32_t sm = encSpeedMilliSps;
  interrupts();
  if (last == 0 || (uint32_t)(now - last) > 250000UL) return 0.0f;
  return (float)sm / 1000.0f;
}

void encReset() {
  noInterrupts();
  encCount = 0;
  encDir = 0;
  encAcc = 0;
  encLastStepUs = 0;
  encSpeedMilliSps = 0;
  interrupts();
}

void encInitPins(int clk, int dt, int sw) {
  if (encInitialized) {
    detachInterrupt(digitalPinToInterrupt(encClkPin));
    detachInterrupt(digitalPinToInterrupt(encDtPin));
    encInitialized = false;
  }
  encClkPin = clk;
  encDtPin = dt;
  encSwPin = sw;
#if defined(ARDUINO_ARCH_ESP32)
  pinMode(encClkPin, (encClkPin >= 34 && encClkPin <= 39) ? INPUT : INPUT_PULLUP);
  pinMode(encDtPin, (encDtPin >= 34 && encDtPin <= 39) ? INPUT : INPUT_PULLUP);
  if (encSwPin >= 0) pinMode(encSwPin, (encSwPin >= 34 && encSwPin <= 39) ? INPUT : INPUT_PULLUP);
#else
  pinMode(encClkPin, INPUT_PULLUP);
  pinMode(encDtPin, INPUT_PULLUP);
  if (encSwPin >= 0) pinMode(encSwPin, INPUT_PULLUP);
#endif
  encReset();
  encPrevState = encReadState();
  attachInterrupt(digitalPinToInterrupt(encClkPin), encISR, CHANGE);
  attachInterrupt(digitalPinToInterrupt(encDtPin), encISR, CHANGE);
  encInitialized = true;
}

bool encButtonPressed() {
  return encInitialized && encSwPin >= 0 && digitalRead(encSwPin) == LOW;
}

// PS2 joystick (up to 8)
#define JOYSTICK_MAX 8
#if defined(ARDUINO_ARCH_ESP32)
#define JOYSTICK_ADC_MAX 4095
#else
#define JOYSTICK_ADC_MAX 1023
#endif
int joystickXPin[JOYSTICK_MAX] = {-1,-1,-1,-1,-1,-1,-1,-1};
int joystickYPin[JOYSTICK_MAX] = {-1,-1,-1,-1,-1,-1,-1,-1};
int joystickSwPin[JOYSTICK_MAX] = {-1,-1,-1,-1,-1,-1,-1,-1};
int joystickCenterX[JOYSTICK_MAX] = {2047,2047,2047,2047,2047,2047,2047,2047};
int joystickCenterY[JOYSTICK_MAX] = {2047,2047,2047,2047,2047,2047,2047,2047};
int joystickDeadzone[JOYSTICK_MAX] = {164,164,164,164,164,164,164,164};
int joystickLowThreshold[JOYSTICK_MAX] = {819,819,819,819,819,819,819,819};
int joystickHighThreshold[JOYSTICK_MAX] = {2730,2730,2730,2730,2730,2730,2730,2730};
bool joystickListening[JOYSTICK_MAX] = {false,false,false,false,false,false,false,false};
bool joystickPreviousPressed[JOYSTICK_MAX] = {false,false,false,false,false,false,false,false};

bool joystickValid(int no) {
  return no >= 0 && no < JOYSTICK_MAX &&
    joystickXPin[no] >= 0 && joystickYPin[no] >= 0;
}

int joystickReadAxis(int no, bool yAxis, bool mapped) {
  int value = analogRead(yAxis ? joystickYPin[no] : joystickXPin[no]);
  return mapped ? map(constrain(value, 0, JOYSTICK_ADC_MAX), 0, JOYSTICK_ADC_MAX, 0, 100) : value;
}

bool joystickButtonPressed(int no) {
  return joystickValid(no) && joystickSwPin[no] >= 0 && digitalRead(joystickSwPin[no]) == LOW;
}

String joystickDirection(int no) {
  int dx = analogRead(joystickXPin[no]) - joystickCenterX[no];
  int dy = analogRead(joystickYPin[no]) - joystickCenterY[no];
  int ax = abs(dx), ay = abs(dy), dz = joystickDeadzone[no];
  if (ax <= dz && ay <= dz) return "CENTER";
  int low = joystickLowThreshold[no];
  float magnitude = sqrtf((float)dx * dx + (float)dy * dy);
  if (magnitude >= joystickHighThreshold[no]) {
    float angle = atan2f((float)dy, (float)dx);
    if (angle >= -0.785398f && angle < 0.785398f) return "RIGHT";
    if (angle >= 0.785398f && angle < 2.35619f) return "DOWN";
    if (angle >= -2.35619f && angle < -0.785398f) return "UP";
    return "LEFT";
  }
  if (ay >= ax && ay >= low) return dy < 0 ? "UP" : "DOWN";
  if (ax > ay && ax >= low) return dx > 0 ? "RIGHT" : "LEFT";
  if (magnitude < low) return "CENTER";
  float angle = atan2f((float)dy, (float)dx);
  if (angle >= -0.785398f && angle < 0.785398f) return "RIGHT";
  if (angle >= 0.785398f && angle < 2.35619f) return "DOWN";
  if (angle >= -2.35619f && angle < -0.785398f) return "UP";
  return "LEFT";
}

float joystickAngle(int no) {
  int dx = analogRead(joystickXPin[no]) - joystickCenterX[no];
  int dy = analogRead(joystickYPin[no]) - joystickCenterY[no];
  if (abs(dx) <= joystickDeadzone[no] && abs(dy) <= joystickDeadzone[no]) return -1.0f;
  float angle = atan2f((float)dy, (float)dx) * 180.0f / 3.14159265f;
  return angle < 0 ? angle + 360.0f : angle;
}

float joystickMagnitude(int no) {
  float dx = analogRead(joystickXPin[no]) - joystickCenterX[no];
  float dy = analogRead(joystickYPin[no]) - joystickCenterY[no];
  return sqrtf(dx * dx + dy * dy);
}

String joystickDirectionLower(int no) {
  String d = joystickDirection(no);
  d.toLowerCase();
  return d;
}

void ps2EnsurePins(int xPin, int yPin, int cx, int cy, int dz) {
  joystickXPin[0] = xPin;
  joystickYPin[0] = yPin;
  pinMode(xPin, INPUT);
  pinMode(yPin, INPUT);
  if (cx >= 0) joystickCenterX[0] = cx;
  if (cy >= 0) joystickCenterY[0] = cy;
  if (dz >= 0) joystickDeadzone[0] = dz;
}

String ps2DirectionFrom(int x, int y, int cx, int cy, int dz) {
  int dx = x - cx;
  int dy = y - cy;
  int dist2 = dx * dx + dy * dy;
  if (dist2 < dz * dz) return "center";
  float angle = atan2f((float)dy, (float)dx) * 180.0f / 3.14159265f;
  if (angle > -45 && angle <= 45) return "right";
  if (angle > 45 && angle <= 135) return "down";
  if (angle > -135 && angle <= -45) return "up";
  return "left";
}

// Project timer / interrupts / serial / DAC / parallel LCD
unsigned long projectTimerStart = 0;
volatile bool irqFired[40];
volatile bool irqArmed[40];
int joyContLastAngle = 90;

#define IRQ_PIN_LIST \
  X(0) X(1) X(2) X(4) X(5) X(12) X(13) X(14) X(15) \
  X(16) X(17) X(18) X(19) X(21) X(22) X(23) X(25) X(26) X(27) \
  X(32) X(33) X(34) X(35) X(36) X(39)

#define X(n) void IRAM_ATTR irqIsr##n() { irqFired[n] = true; }
IRQ_PIN_LIST
#undef X

void attachIrqPin(int pin, int mode) {
  void (*handler)() = NULL;
  switch (pin) {
#define X(n) case n: handler = irqIsr##n; break;
    IRQ_PIN_LIST
#undef X
  }
  if (!handler) return;
  attachInterrupt(digitalPinToInterrupt(pin), handler, mode);
}

int irqModeFromText(const char* mode) {
  if (!strcasecmp(mode, "RISING")) return RISING;
  if (!strcasecmp(mode, "FALLING")) return FALLING;
  if (!strcasecmp(mode, "CHANGE")) return CHANGE;
  if (!strcasecmp(mode, "LOW")) return LOW;
  if (!strcasecmp(mode, "HIGH") || !strcasecmp(mode, "High")) return HIGH;
  return RISING;
}

HardwareSerial* wifiSerialPort(int no) {
  if (no == 2) return &Serial2;
  return &Serial;
}

int lcdStdRs = -1, lcdStdE = -1, lcdStdD4 = -1, lcdStdD5 = -1, lcdStdD6 = -1, lcdStdD7 = -1;
bool lcdStdReady = false;

void lcdStdPulse() {
  digitalWrite(lcdStdE, HIGH);
  delayMicroseconds(1);
  digitalWrite(lcdStdE, LOW);
  delayMicroseconds(50);
}

void lcdStdNibble(uint8_t nibble) {
  digitalWrite(lcdStdD4, nibble & 0x01);
  digitalWrite(lcdStdD5, (nibble >> 1) & 0x01);
  digitalWrite(lcdStdD6, (nibble >> 2) & 0x01);
  digitalWrite(lcdStdD7, (nibble >> 3) & 0x01);
  lcdStdPulse();
}

void lcdStdCmd(uint8_t value) {
  digitalWrite(lcdStdRs, LOW);
  lcdStdNibble(value >> 4);
  lcdStdNibble(value & 0x0F);
}

void lcdStdData(uint8_t value) {
  digitalWrite(lcdStdRs, HIGH);
  lcdStdNibble(value >> 4);
  lcdStdNibble(value & 0x0F);
}

void lcdStdInit(int rs, int e, int d4, int d5, int d6, int d7) {
  lcdStdRs = rs; lcdStdE = e; lcdStdD4 = d4; lcdStdD5 = d5; lcdStdD6 = d6; lcdStdD7 = d7;
  pinMode(rs, OUTPUT); pinMode(e, OUTPUT);
  pinMode(d4, OUTPUT); pinMode(d5, OUTPUT); pinMode(d6, OUTPUT); pinMode(d7, OUTPUT);
  delay(50);
  lcdStdNibble(0x03); delay(5);
  lcdStdNibble(0x03); delayMicroseconds(150);
  lcdStdNibble(0x03); delayMicroseconds(150);
  lcdStdNibble(0x02);
  lcdStdCmd(0x28);
  lcdStdCmd(0x0C);
  lcdStdCmd(0x01);
  delay(2);
  lcdStdCmd(0x06);
  lcdStdReady = true;
}

bool lcdAnyReady() {
  return (lcdReady && lcdI2c != nullptr) || lcdStdReady;
}

void lcdWriteText(const String& text) {
  if (lcdReady && lcdI2c != nullptr) lcdI2c->print(text);
  else if (lcdStdReady) {
    for (unsigned i = 0; i < text.length(); i++) lcdStdData((uint8_t)text[i]);
  }
}

int readHallSafe() {
#if defined(ESP_ARDUINO_VERSION_MAJOR) && (ESP_ARDUINO_VERSION_MAJOR >= 3)
  return 0;
#else
  return hallRead();
#endif
}

void writeDacSafe(int pin, int value) {
  value = constrain(value, 0, 255);
  if (pin == 25 || pin == 26) {
    dacWrite(pin, value);
    return;
  }
  analogWrite(pin, value);          // PWM, works on ESP32 core 2.x and 3.x
}

void initializeWiFi() {
#if defined(ARDUINO_ARCH_ESP32)
  WRITE_PERI_REG(RTC_CNTL_BROWN_OUT_REG, 0);
#endif
  WiFi.persistent(false);
  WiFi.mode(WIFI_STA);
  WiFi.setSleep(false);
  Serial.println("Connecting to WiFi...");
  for (int round = 0; round < 4; round++) {
    Serial.print("WiFi try ");
    Serial.println(round + 1);
    WiFi.disconnect(false, false);
    delay(200);
    WiFi.begin(ssid, password);
    unsigned long startAttemptTime = millis();
    while (WiFi.status() != WL_CONNECTED) {
      if (millis() - startAttemptTime >= 12000) break;
      delay(500);
      Serial.print(".");
    }
    Serial.println("");
    if (WiFi.status() == WL_CONNECTED) break;
    Serial.println("WiFi retry...");
  }

  if (WiFi.status() == WL_CONNECTED) {
    Serial.println("Connected to WiFi");
    Serial.flush();
    delay(300);
    IPAddress ip = WiFi.localIP();
    Serial.print("IP ");
    Serial.print((int)ip[0]);
    Serial.print(".");
    Serial.print((int)ip[1]);
    Serial.print(".");
    Serial.print((int)ip[2]);
    Serial.print(".");
    Serial.println((int)ip[3]);
    Serial.flush();
  } else {
    Serial.println("WiFi not joined yet. HTTP server still starts; will retry in loop.");
  }

  server.on("/connect", HTTP_GET, []() {
    server.sendHeader("Access-Control-Allow-Origin", "*");
    server.send(200, "text/plain", "OK");
  });
  server.on("/connect", HTTP_POST, []() {
    server.sendHeader("Access-Control-Allow-Origin", "*");
    server.send(200, "text/plain", "OK");
  });
  server.on("/connect", HTTP_OPTIONS, []() {
    server.sendHeader("Access-Control-Allow-Origin", "*");
    server.sendHeader("Access-Control-Allow-Methods", "GET, POST, OPTIONS");
    server.sendHeader("Access-Control-Allow-Headers", "Content-Type");
    server.send(204, "text/plain", "");
  });
  server.on("/disconnect", HTTP_GET, []() {
    server.sendHeader("Access-Control-Allow-Origin", "*");
    server.send(200, "text/plain", "OK");
  });
  server.on("/disconnect", HTTP_POST, []() {
    server.sendHeader("Access-Control-Allow-Origin", "*");
    server.send(200, "text/plain", "OK");
  });

  server.on("/control", HTTP_POST, []() {
    server.sendHeader("Access-Control-Allow-Origin", "*");

    String cmd;
    if (server.hasArg("plain")) {
      cmd = server.arg("plain");
    } else if (server.hasArg("body")) {
      cmd = server.arg("body");
    } else {
      server.send(400, "text/plain", "No data");
      return;
    }
    cmd.trim();
    if (cmd == "COLOUR_INIT") cmd = "TCS34725_INIT";
    else if (cmd.startsWith("COLOUR_LED")) cmd.replace("COLOUR_LED", "TCS34725_LED");
    else if (cmd == "COLOUR_READ") cmd = "TCS34725_READ";
    else if (cmd.startsWith("COLOUR_TEMP")) cmd = "TCS34725_COLOR_TEMP";
    else if (cmd.startsWith("COLOUR_LUX")) cmd = "TCS34725_LUX";
    else if (cmd.startsWith("COLOUR_IS ")) cmd.replace("COLOUR_IS ", "TCS34725_IS_COLOR ");
    else if (cmd.startsWith("COLOUR_NAME")) cmd = "TCS34725_GET_NAME";
    else if (cmd.startsWith("COLOUR_GET_RGB")) cmd = "TCS34725_GET_RGB";
    else if (cmd.startsWith("ENCODER_LISTEN_BUTTON")) cmd.replace("ENCODER_LISTEN_BUTTON", "ENCODER_BUTTON_LISTEN");
    else if (cmd.startsWith("LCD_WRITE ")) cmd.replace("LCD_WRITE ", "LCD_PRINT_CHAR ");
    else if (cmd.startsWith("LEDMATRIX_LETTER")) cmd.replace("LEDMATRIX_LETTER", "LEDMATRIX_CHAR");
    else if (cmd.startsWith("ULTRASONIC_DIST ") || cmd.startsWith("ULTRASONIC_D ")) {
      cmd.replace("ULTRASONIC_DIST ", "ULTRASONIC_READ ");
      cmd.replace("ULTRASONIC_D ", "ULTRASONIC_READ ");
    }
    Serial.println("Received: " + cmd);

    // ================= SET PIN MODE =================
    if (cmd.startsWith("SET_PIN_MODE")) {
      int pin;
      char mode[10];
      if (sscanf(cmd.c_str(), "SET_PIN_MODE %d %s", &pin, mode) == 2) {
        pinMode(pin, strcmp(mode, "INPUT") == 0 ? INPUT :
          (strcmp(mode, "INPUT_PULLUP") == 0 ? INPUT_PULLUP : OUTPUT));
        server.send(200, "text/plain", "OK");
      } else {
        server.send(400, "text/plain", "INVALID_FORMAT");
      }
      return;
    }

    // ================= SET DIGITAL OUTPUT =================
    if (cmd.startsWith("SET_DIGITAL_OUTPUT")) {
      int pin[4];
      char state[4][10];
      int count = sscanf(
        cmd.c_str(),
        "SET_DIGITAL_OUTPUT %d %s %d %s %d %s %d %s",
        &pin[0], state[0],
        &pin[1], state[1],
        &pin[2], state[2],
        &pin[3], state[3]
      );
      for (int i = 0; i < count / 2; i++) {
        pinMode(pin[i], OUTPUT);
        digitalWrite(pin[i], strcmp(state[i], "HIGH") == 0 ? HIGH : LOW);
      }
      delay(50);
      server.send(200, "text/plain", "OK");
      return;
    }

    // ================= DIGITAL WRITE =================
    if (cmd.startsWith("DIGITAL_WRITE")) {
      int pin, val;
      if (sscanf(cmd.c_str(), "DIGITAL_WRITE %d %d", &pin, &val) == 2) {
        pinMode(pin, OUTPUT);
        digitalWrite(pin, val);
        server.send(200, "text/plain", "OK");
      } else {
        server.send(400, "text/plain", "INVALID_FORMAT");
      }
      return;
    }

    // ================= DIGITAL READ =================
    if (cmd.startsWith("DIGITAL_READ") || cmd.startsWith("READ_DIGITAL_PIN")) {
      int pin;
      int parsed = cmd.startsWith("READ_DIGITAL_PIN")
        ? sscanf(cmd.c_str(), "READ_DIGITAL_PIN %d", &pin)
        : sscanf(cmd.c_str(), "DIGITAL_READ %d", &pin);
      if (parsed == 1) {
        pinMode(pin, INPUT);
        int value = digitalRead(pin);
        server.send(200, "text/plain", String(value));
      } else {
        server.send(400, "text/plain", "INVALID_FORMAT");
      }
      return;
    }

    // ================= ANALOG READ =================
    if (cmd.startsWith("READ_ANALOG")) {
      int pin;
      if (sscanf(cmd.c_str(), "READ_ANALOG %d", &pin) == 1) {
        int value = analogRead(pin);
        server.send(200, "text/plain", String(value));
      } else {
        server.send(400, "text/plain", "INVALID_FORMAT");
      }
      return;
    }

    // ================= PWM OUTPUT =================
    if (cmd.startsWith("SET_PWM_OUTPUT")) {
      int pin, value;
      if (sscanf(cmd.c_str(), "SET_PWM_OUTPUT %d %d", &pin, &value) == 2) {
        analogWrite(pin, constrain(value, 0, 255));   // PWM, works on ESP32 core 2.x and 3.x
        server.send(200, "text/plain", "OK");
      } else {
        server.send(400, "text/plain", "INVALID_FORMAT");
      }
      return;
    }

    // ================= SERVO OUTPUT =================
    if (cmd.startsWith("SET_SERVO_OUTPUT")) {
      int pin, angle;
      if (sscanf(cmd.c_str(), "SET_SERVO_OUTPUT %d %d", &pin, &angle) == 2) {
        __blockly_servo__.attach(pin);
        __blockly_servo__.write(angle);
        server.send(200, "text/plain", "OK");
      } else {
        server.send(400, "text/plain", "INVALID_FORMAT");
      }
      return;
    }

    if (cmd.startsWith("SERVO_ATTACH")) {
      int pin;
      if (sscanf(cmd.c_str(), "SERVO_ATTACH %d", &pin) == 1) {
        __blockly_servo__.attach(pin);
        server.send(200, "text/plain", "OK");
      } else {
        server.send(400, "text/plain", "INVALID_FORMAT");
      }
      return;
    }

    if (cmd.startsWith("SET_DAC_OUTPUT")) {
      int pin, value;
      if (sscanf(cmd.c_str(), "SET_DAC_OUTPUT %d %d", &pin, &value) == 2) {
        writeDacSafe(pin, value);
        server.send(200, "text/plain", "OK");
      } else {
        server.send(400, "text/plain", "INVALID_FORMAT");
      }
      return;
    }

    if (cmd.startsWith("READ_TOUCH_PIN")) {
      int pin;
      if (sscanf(cmd.c_str(), "READ_TOUCH_PIN %d", &pin) == 1) {
        server.send(200, "text/plain", String(touchRead(pin)));
      } else {
        server.send(400, "text/plain", "INVALID_FORMAT");
      }
      return;
    }

    if (cmd.startsWith("READ_HALL_SENSOR")) {
      server.send(200, "text/plain", String(readHallSafe()));
      return;
    }

    if (cmd.startsWith("GET_MILLIS")) {
      server.send(200, "text/plain", String(millis()));
      return;
    }

    if (cmd.startsWith("RESET_TIMER")) {
      projectTimerStart = millis();
      server.send(200, "text/plain", "OK");
      return;
    }

    if (cmd.startsWith("GET_TIMER")) {
      server.send(200, "text/plain", String(millis() - projectTimerStart));
      return;
    }

    if (cmd.startsWith("ATTACH_INTERRUPT")) {
      int pin;
      char mode[16];
      if (sscanf(cmd.c_str(), "ATTACH_INTERRUPT %d %15s", &pin, mode) == 2 && pin >= 0 && pin < 40) {
        irqFired[pin] = false;
        irqArmed[pin] = true;
        attachIrqPin(pin, irqModeFromText(mode));
        server.send(200, "text/plain", "OK");
      } else {
        server.send(400, "text/plain", "INVALID_FORMAT");
      }
      return;
    }

    if (cmd.startsWith("INTERRUPT_FIRED")) {
      int pin;
      if (sscanf(cmd.c_str(), "INTERRUPT_FIRED %d", &pin) == 1 && pin >= 0 && pin < 40) {
        bool fired = irqFired[pin];
        irqFired[pin] = false;
        server.send(200, "text/plain", fired ? "1" : "0");
      } else {
        server.send(400, "text/plain", "INVALID_FORMAT");
      }
      return;
    }

    if (cmd.startsWith("DETACH_INTERRUPT")) {
      int pin;
      if (sscanf(cmd.c_str(), "DETACH_INTERRUPT %d", &pin) == 1 && pin >= 0 && pin < 40) {
        detachInterrupt(digitalPinToInterrupt(pin));
        irqArmed[pin] = false;
        irqFired[pin] = false;
        server.send(200, "text/plain", "OK");
      } else {
        server.send(400, "text/plain", "INVALID_FORMAT");
      }
      return;
    }

    if (cmd.startsWith("DATA_MAP")) {
      float data, inMin, inMax, outMin, outMax;
      if (sscanf(cmd.c_str(), "DATA_MAP %f %f %f %f %f", &data, &inMin, &inMax, &outMin, &outMax) == 5) {
        float mapped = (inMax == inMin) ? outMin : (data - inMin) * (outMax - outMin) / (inMax - inMin) + outMin;
        server.send(200, "text/plain", String(mapped));
      } else {
        server.send(400, "text/plain", "INVALID_FORMAT");
      }
      return;
    }

    if (cmd.startsWith("DATA_CONSTRAIN")) {
      float data, lo, hi;
      if (sscanf(cmd.c_str(), "DATA_CONSTRAIN %f %f %f", &data, &lo, &hi) == 3) {
        server.send(200, "text/plain", String(constrain(data, lo, hi)));
      } else {
        server.send(400, "text/plain", "INVALID_FORMAT");
      }
      return;
    }

    if (cmd.startsWith("DATA_CONVERT")) {
      char typ[16];
      int consumed = 0;
      if (sscanf(cmd.c_str(), "DATA_CONVERT %15s %n", typ, &consumed) >= 1 && consumed > 0) {
        String payload = cmd.substring(consumed);
        payload.trim();
        if (!strcasecmp(typ, "INTEGER")) server.send(200, "text/plain", String(payload.toInt()));
        else if (!strcasecmp(typ, "DECIMAL")) server.send(200, "text/plain", String(payload.toFloat()));
        else server.send(200, "text/plain", payload);
      } else {
        server.send(400, "text/plain", "INVALID_FORMAT");
      }
      return;
    }

    if (cmd.startsWith("DATA_ASCII_CHAR")) {
      int code;
      if (sscanf(cmd.c_str(), "DATA_ASCII_CHAR %d", &code) == 1) {
        char out[2] = { (char)(code & 0xFF), 0 };
        server.send(200, "text/plain", String(out));
      } else {
        server.send(400, "text/plain", "INVALID_FORMAT");
      }
      return;
    }

    if (cmd.startsWith("DATA_ASCII_NUM")) {
      String rest = cmd.substring(String("DATA_ASCII_NUM").length());
      rest.trim();
      int code = rest.length() > 0 ? (int)(uint8_t)rest.charAt(0) : 0;
      server.send(200, "text/plain", String(code));
      return;
    }

    // ================= TM1637 INIT =================
    if (cmd.startsWith("TM1637_INIT")) {
      int dio, clk;
      if (sscanf(cmd.c_str(), "TM1637_INIT %d %d", &dio, &clk) == 2) {
        if (tm1637Display == nullptr) {
          tm1637Display = new TM1637Display(clk, dio);
          tm1637Display->setBrightness(7);
          tm1637Display->clear();
        }
        server.send(200, "text/plain", "OK");
      } else {
        server.send(400, "text/plain", "INVALID_FORMAT");
      }
      return;
    }

    // ================= TM1637 BRIGHTNESS =================
    if (cmd.startsWith("TM1637_BRIGHTNESS")) {
      int brightness;
      if (sscanf(cmd.c_str(), "TM1637_BRIGHTNESS %d", &brightness) == 1 && tm1637Display != nullptr) {
        tm1637Display->setBrightness(brightness);
        server.send(200, "text/plain", "OK");
      } else {
        server.send(400, "text/plain", "NOT_INITIALIZED");
      }
      return;
    }

    // ================= TM1637 ADVANCED NUMBER =================
    if (cmd.startsWith("TM1637_NUMBER_EX")) {
      int number, length, position, leadingZeros;
      if (sscanf(cmd.c_str(), "TM1637_NUMBER_EX %d %d %d %d", &number, &length, &position, &leadingZeros) == 4 &&
          tm1637Display != nullptr) {
        length = constrain(length, 1, 4);
        position = constrain(position, 0, 3);
        if (position + length > 4) length = 4 - position;
        tm1637Display->showNumberDecEx(number, tm1637Dots, leadingZeros != 0, length, position);
        tm1637LastNumber = number;
        tm1637LastLength = length;
        tm1637LastPosition = position;
        tm1637LastLeadingZeros = leadingZeros != 0;
        tm1637HasLastNumber = true;
        server.send(200, "text/plain", "OK");
      } else {
        server.send(400, "text/plain", "NOT_INITIALIZED");
      }
      return;
    }

    if (cmd.startsWith("TM1637_NUMBER_DOTS")) {
      int number, length, position, dots, leadingZeros;
      if (sscanf(cmd.c_str(), "TM1637_NUMBER_DOTS %d %d %d %i %d",
          &number, &length, &position, &dots, &leadingZeros) == 5 && tm1637Display != nullptr) {
        length = constrain(length, 1, 4);
        position = constrain(position, 0, 3);
        if (position + length > 4) length = 4 - position;
        tm1637Dots = (uint8_t)dots;
        tm1637Display->showNumberDecEx(number, tm1637Dots, leadingZeros != 0, length, position);
        tm1637LastNumber = number;
        tm1637LastLength = length;
        tm1637LastPosition = position;
        tm1637LastLeadingZeros = leadingZeros != 0;
        tm1637HasLastNumber = true;
        server.send(200, "text/plain", "OK");
      } else {
        server.send(400, "text/plain", "NOT_INITIALIZED");
      }
      return;
    }

    // ================= TM1637 NUMBER =================
    if (cmd.startsWith("TM1637_NUMBER")) {
      int number;
      if (sscanf(cmd.c_str(), "TM1637_NUMBER %d", &number) == 1 && tm1637Display != nullptr) {
        tm1637Display->showNumberDecEx(number, tm1637Dots, false, 4, 0);
        tm1637LastNumber = number;
        tm1637LastLength = 4;
        tm1637LastPosition = 0;
        tm1637LastLeadingZeros = false;
        tm1637HasLastNumber = true;
        server.send(200, "text/plain", "OK");
      } else {
        server.send(400, "text/plain", "NOT_INITIALIZED");
      }
      return;
    }

    // ================= TM1637 STRING (digits + letters e.g. Open) =================
    if (cmd.startsWith("TM1637_STRING")) {
      char data[10];
      if (sscanf(cmd.c_str(), "TM1637_STRING %s", data) == 1 && tm1637Display != nullptr) {
        int len = (int)strlen(data);
        if (len > 4) len = 4;
        for (int i = 0; i < len; i++) {
          uint8_t seg = tm1637SegmentForChar(data[i]);
          tm1637Segments[i] = seg;
          tm1637Display->setSegments(&seg, 1, i);
        }
        tm1637HasLastNumber = false;
        server.send(200, "text/plain", "OK");
      } else {
        server.send(400, "text/plain", "NOT_INITIALIZED");
      }
      return;
    }

    // ================= TM1637 SEGMENTS =================
    if (cmd.startsWith("TM1637_SEGMENTS")) {
      int length, position, consumed = 0;
      int parsed = sscanf(cmd.c_str(), "TM1637_SEGMENTS %d %d %n", &length, &position, &consumed);
      if (parsed == 2 && consumed > 0 && tm1637Display != nullptr) {
        uint8_t values[4] = {0, 0, 0, 0};
        String expressions = cmd.substring(consumed);
        int valueCount = 0;
        while (expressions.length() > 0 && valueCount < 4) {
          int comma = expressions.indexOf(',');
          String item = comma >= 0 ? expressions.substring(0, comma) : expressions;
          values[valueCount++] = tm1637ParseSegmentExpr(item);
          if (comma < 0) break;
          expressions = expressions.substring(comma + 1);
        }
        length = constrain(length, 1, 4);
        if (length > valueCount) length = valueCount;
        position = constrain(position, 0, 3);
        if (position + length > 4) length = 4 - position;
        tm1637Display->setSegments(values, length, position);
        for (int i = 0; i < length; i++) tm1637Segments[position + i] = values[i];
        tm1637HasLastNumber = false;
        server.send(200, "text/plain", "OK");
      } else {
        server.send(400, "text/plain", "INVALID_FORMAT");
      }
      return;
    }

    // ================= TM1637 RAW BIT =================
    if (cmd.startsWith("TM1637_BIT")) {
      int data, pos;
      if (sscanf(cmd.c_str(), "TM1637_BIT %i %d", &data, &pos) == 2 &&
          tm1637Display != nullptr && pos >= 0 && pos < 4) {
        uint8_t segment = (uint8_t)data;
        tm1637Segments[pos] = segment;
        tm1637Display->setSegments(&segment, 1, pos);
        tm1637HasLastNumber = false;
        server.send(200, "text/plain", "OK");
      } else {
        server.send(400, "text/plain", "INVALID_FORMAT");
      }
      return;
    }

    // ================= TM1637 DIGIT =================
    if (cmd.startsWith("TM1637_DIGIT")) {
      int digit, pos;
      if (sscanf(cmd.c_str(), "TM1637_DIGIT %d %d", &digit, &pos) == 2 && tm1637Display != nullptr) {
        uint8_t segment = tm1637Display->encodeDigit(constrain(digit, 0, 9));
        tm1637Segments[constrain(pos, 0, 3)] = segment;
        tm1637Display->setSegments(&segment, 1, constrain(pos, 0, 3));
        tm1637HasLastNumber = false;
        server.send(200, "text/plain", "OK");
      } else {
        server.send(400, "text/plain", "NOT_INITIALIZED");
      }
      return;
    }

    // ================= TM1637 CLEAR =================
    if (cmd.startsWith("TM1637_CLEAR")) {
      if (tm1637Display != nullptr) {
        tm1637Display->clear();
        memset(tm1637Segments, 0, sizeof(tm1637Segments));
        tm1637HasLastNumber = false;
        server.send(200, "text/plain", "OK");
      } else {
        server.send(400, "text/plain", "NOT_INITIALIZED");
      }
      return;
    }

    // ================= TM1637 POINT / COLON =================
    if (cmd.startsWith("TM1637_POINT") || cmd.startsWith("TM1637_COLON")) {
      char state[10];
      int parsed = cmd.startsWith("TM1637_POINT")
        ? sscanf(cmd.c_str(), "TM1637_POINT %s", state)
        : sscanf(cmd.c_str(), "TM1637_COLON %s", state);
      if (parsed == 1 && tm1637Display != nullptr) {
        bool pointOn = strcmp(state, "true") == 0 || strcmp(state, "on") == 0 || strcmp(state, "1") == 0;
        tm1637Dots = pointOn ? 0x40 : 0;
        if (tm1637HasLastNumber) {
          tm1637Display->showNumberDecEx(
            tm1637LastNumber, tm1637Dots, tm1637LastLeadingZeros,
            tm1637LastLength, tm1637LastPosition
          );
        }
        server.send(200, "text/plain", "OK");
      } else {
        server.send(400, "text/plain", "NOT_INITIALIZED");
      }
      return;
    }

    if (cmd.startsWith("TM1637_SHOW_TIME")) {
      int hour, minute;
      if (sscanf(cmd.c_str(), "TM1637_SHOW_TIME %d %d", &hour, &minute) == 2 && tm1637Display != nullptr) {
        hour = constrain(hour, 0, 99);
        minute = constrain(minute, 0, 99);
        int value = hour * 100 + minute;
        tm1637Dots = 0x40;
        tm1637Display->showNumberDecEx(value, tm1637Dots, true, 4, 0);
        tm1637LastNumber = value;
        tm1637LastLength = 4;
        tm1637LastPosition = 0;
        tm1637LastLeadingZeros = true;
        tm1637HasLastNumber = true;
        server.send(200, "text/plain", "OK");
      } else {
        server.send(400, "text/plain", "NOT_INITIALIZED");
      }
      return;
    }

    if (cmd.startsWith("TM1637_SET_SEGMENTS")) {
      int length, position, s0 = 0, s1 = 0, s2 = 0, s3 = 0;
      int parsed = sscanf(cmd.c_str(), "TM1637_SET_SEGMENTS %d %d %d %d %d %d",
        &length, &position, &s0, &s1, &s2, &s3);
      if (parsed >= 3 && tm1637Display != nullptr) {
        uint8_t values[4] = { (uint8_t)s0, (uint8_t)s1, (uint8_t)s2, (uint8_t)s3 };
        length = constrain(length, 1, 4);
        if (length > parsed - 2) length = parsed - 2;
        if (length < 1) length = 1;
        position = constrain(position, 0, 3);
        if (position + length > 4) length = 4 - position;
        tm1637Display->setSegments(values, length, position);
        for (int i = 0; i < length; i++) tm1637Segments[position + i] = values[i];
        tm1637HasLastNumber = false;
        server.send(200, "text/plain", "OK");
      } else {
        server.send(400, "text/plain", "INVALID_FORMAT");
      }
      return;
    }

    // ================= DHT INIT =================
    if (cmd.startsWith("DHT_INIT")) {
      int no = 1, pin = -1, model = 11;
      char modelStr[16];
      if (sscanf(cmd.c_str(), "DHT_INIT %d %d %15s", &no, &pin, modelStr) == 3) {
        model = dhtParseModel(modelStr);
      } else if (sscanf(cmd.c_str(), "DHT_INIT %d %d", &pin, &model) == 2) {
        no = 1;
      } else {
        server.send(400, "text/plain", "INVALID_FORMAT");
        return;
      }
      if (no >= 0 && no <= 4 && pin >= 0) {
        dhtPins[no] = (uint8_t)pin;
        dhtTypes[no] = (uint8_t)model;
        dhtLastTemp[no] = NAN;
        dhtLastHum[no] = NAN;
        if (dhtSensors[no] != nullptr) delete dhtSensors[no];
        dhtSensors[no] = new DHT(pin, model);
        dhtSensors[no]->begin();
        pinMode(pin, INPUT_PULLUP);
        server.send(200, "text/plain", "OK");
      } else {
        server.send(400, "text/plain", "INVALID_FORMAT");
      }
      return;
    }

    // ================= DHT READ TEMPERATURE =================
    if (cmd.startsWith("DHT_READ_TEMP") || cmd.startsWith("DHT_TEMP")) {
      int no = 1, isFahrenheit = 0;
      if (cmd.startsWith("DHT_READ_TEMP")) {
        sscanf(cmd.c_str(), "DHT_READ_TEMP %d %d", &no, &isFahrenheit);
      } else {
        sscanf(cmd.c_str(), "DHT_TEMP %d", &no);
      }
      float tempC = NAN, hum = NAN;
      if (dhtReadSlot(no, &tempC, &hum)) {
        float temp = isFahrenheit ? (tempC * 9.0f / 5.0f + 32.0f) : tempC;
        server.send(200, "text/plain", String(temp, 2));
      } else if (no < 0 || no > 4 || dhtPins[no] == 255) {
        server.send(400, "text/plain", "NOT_INITIALIZED");
      } else {
        server.send(400, "text/plain", "READ_ERROR");
      }
      return;
    }

    // ================= DHT READ HUMIDITY =================
    if (cmd.startsWith("DHT_READ_HUM") || cmd.startsWith("DHT_HUM")) {
      int no = 1;
      sscanf(cmd.c_str(), "%*s %d", &no);
      float tempC = NAN, hum = NAN;
      if (dhtReadSlot(no, &tempC, &hum)) {
        server.send(200, "text/plain", String(hum, 2));
      } else if (no < 0 || no > 4 || dhtPins[no] == 255) {
        server.send(400, "text/plain", "NOT_INITIALIZED");
      } else {
        server.send(400, "text/plain", "READ_ERROR");
      }
      return;
    }

    // ================= ULTRASONIC INIT / READ =================
    if (cmd.startsWith("ULTRASONIC_INIT")) {
      int no, trig, echo;
      if (sscanf(cmd.c_str(), "ULTRASONIC_INIT %d %d %d", &no, &trig, &echo) == 3) {
        ultrasonicTrig = trig;
        ultrasonicEcho = echo;
        pinMode(trig, OUTPUT);
        pinMode(echo, INPUT);
        server.send(200, "text/plain", "OK");
      } else {
        server.send(400, "text/plain", "INVALID_FORMAT");
      }
      return;
    }

    if (cmd.startsWith("ULTRASONIC_READ")) {
      int trig, echo, isInch;
      if (sscanf(cmd.c_str(), "ULTRASONIC_READ %d %d %d", &trig, &echo, &isInch) == 3) {
        pinMode(trig, OUTPUT);
        pinMode(echo, INPUT);
        digitalWrite(trig, LOW);
        delayMicroseconds(2);
        digitalWrite(trig, HIGH);
        delayMicroseconds(10);
        digitalWrite(trig, LOW);
        long duration = pulseIn(echo, HIGH, 30000UL);
        float distance = duration * (isInch ? 0.0133 : 0.034) / 2.0;
        server.send(200, "text/plain", String("ULTRASONIC_DIST ") + String(distance, 2));
      } else {
        server.send(400, "text/plain", "INVALID_FORMAT");
      }
      return;
    }

    // ================= TCS34725 INIT =================
    if (cmd.startsWith("TCS34725_INIT")) {
      if (tcs34725 == nullptr) {
        tcs34725 = new Adafruit_TCS34725(TCS34725_INTEGRATIONTIME_50MS, TCS34725_GAIN_4X);
        if (tcs34725->begin()) {
          server.send(200, "text/plain", "OK");
        } else {
          server.send(400, "text/plain", "INIT_FAILED");
        }
      } else {
        server.send(200, "text/plain", "OK");
      }
      return;
    }

    // ================= TCS34725 READ =================
    if (cmd.startsWith("TCS34725_READ")) {
      if (tcs34725 != nullptr) {
        tcs34725Update();
        server.send(200, "text/plain", "OK");
      } else {
        server.send(400, "text/plain", "NOT_INITIALIZED");
      }
      return;
    }

    // ================= TCS34725 LED =================
    if (cmd.startsWith("TCS34725_LED")) {
      char state[8];
      if (sscanf(cmd.c_str(), "TCS34725_LED %s", state) == 1 && tcs34725 != nullptr) {
        bool ledOn = strcmp(state, "ON") == 0 || strcmp(state, "on") == 0 || strcmp(state, "1") == 0;
        tcs34725->setInterrupt(!ledOn);
        server.send(200, "text/plain", "OK");
      } else {
        server.send(400, "text/plain", "NOT_INITIALIZED");
      }
      return;
    }

    // ================= TCS34725 COLOR TEMPERATURE =================
    if (cmd.startsWith("TCS34725_COLOR_TEMP")) {
      if (tcs34725 != nullptr) {
        tcs34725Update();
        uint16_t value = tcs34725->calculateColorTemperature_dn40(
          tcs34725Color[0], tcs34725Color[1], tcs34725Color[2], tcs34725Color[3]
        );
        server.send(200, "text/plain", String(value));
      } else {
        server.send(400, "text/plain", "NOT_INITIALIZED");
      }
      return;
    }

    // ================= TCS34725 LUX =================
    if (cmd.startsWith("TCS34725_LUX")) {
      if (tcs34725 != nullptr) {
        tcs34725Update();
        uint16_t value = tcs34725->calculateLux(
          tcs34725Color[0], tcs34725Color[1], tcs34725Color[2]
        );
        server.send(200, "text/plain", String(value));
      } else {
        server.send(400, "text/plain", "NOT_INITIALIZED");
      }
      return;
    }

    // ================= TCS34725 DETECTED COLOR NAME =================
    if (cmd.startsWith("TCS34725_GET_NAME") || cmd.startsWith("COLOUR_NAME")) {
      if (tcs34725 != nullptr) {
        server.send(200, "text/plain", tcs34725DetectColour());
      } else {
        server.send(400, "text/plain", "NOT_INITIALIZED");
      }
      return;
    }

    if (cmd.startsWith("TCS34725_GET_RGB")) {
      if (tcs34725 != nullptr) {
        tcs34725Update();
        uint16_t c = tcs34725Color[3] == 0 ? 1 : tcs34725Color[3];
        int r = constrain((int)((float)tcs34725Color[0] / c * 255.0f), 0, 255);
        int g = constrain((int)((float)tcs34725Color[1] / c * 255.0f), 0, 255);
        int b = constrain((int)((float)tcs34725Color[2] / c * 255.0f), 0, 255);
        server.send(200, "text/plain", "RGB " + String(r) + " " + String(g) + " " + String(b));
      } else {
        server.send(400, "text/plain", "NOT_INITIALIZED");
      }
      return;
    }

    // ================= TCS34725 GET COLOR =================
    if (cmd.startsWith("TCS34725_GET_COLOR")) {
      if (tcs34725 != nullptr) {
        char colorType[16];
        int n = sscanf(cmd.c_str(), "TCS34725_GET_COLOR %15s", colorType);
        if (n != 1 || strlen(colorType) > 1) {
          server.send(200, "text/plain", tcs34725DetectColour());
        } else {
          tcs34725Update();
          int value = 0;
          if (colorType[0] == 'R' || colorType[0] == 'r') value = tcs34725Color[0];
          else if (colorType[0] == 'G' || colorType[0] == 'g') value = tcs34725Color[1];
          else if (colorType[0] == 'B' || colorType[0] == 'b') value = tcs34725Color[2];
          else if (colorType[0] == 'C' || colorType[0] == 'c') value = tcs34725Color[3];
          else {
            server.send(200, "text/plain", tcs34725DetectColour());
            return;
          }
          server.send(200, "text/plain", String(value));
        }
      } else {
        server.send(400, "text/plain", "NOT_INITIALIZED");
      }
      return;
    }

    // ================= TCS34725 IS COLOR =================
    if (cmd.startsWith("TCS34725_IS_COLOR")) {
      char targetColor[10];
      if (sscanf(cmd.c_str(), "TCS34725_IS_COLOR %s", targetColor) == 1 && tcs34725 != nullptr) {
        String detected = tcs34725DetectColour();
        String target = String(targetColor);
        target.toUpperCase();
        bool isColor = detected == target;
        server.send(200, "text/plain", isColor ? "1" : "0");
      } else {
        server.send(400, "text/plain", "NOT_INITIALIZED");
      }
      return;
    }

    if (cmd.startsWith("TCS3200_INIT")) {
      int s0, s1, s2, s3, p5, p6 = -1;
      int n = sscanf(cmd.c_str(), "TCS3200_INIT %d %d %d %d %d %d", &s0, &s1, &s2, &s3, &p5, &p6);
      if (n >= 5) {
        tcs3200S0 = s0; tcs3200S1 = s1; tcs3200S2 = s2; tcs3200S3 = s3;
        tcs3200Out = (n >= 6) ? p6 : p5;
        tcs3200Oe = (n >= 6) ? p5 : -1;
        pinMode(tcs3200S0, OUTPUT); pinMode(tcs3200S1, OUTPUT);
        pinMode(tcs3200S2, OUTPUT); pinMode(tcs3200S3, OUTPUT);
        pinMode(tcs3200Out, INPUT);
        digitalWrite(tcs3200S0, HIGH);
        digitalWrite(tcs3200S1, HIGH);
        if (tcs3200Oe >= 0) { pinMode(tcs3200Oe, OUTPUT); digitalWrite(tcs3200Oe, LOW); }
        tcs3200Ready = true;
        server.send(200, "text/plain", "OK");
      } else {
        server.send(400, "text/plain", "INVALID_FORMAT");
      }
      return;
    }

    if (cmd.startsWith("TCS3200_CALIBRATE_WHITE")) {
      if (!tcs3200Ready) { server.send(400, "text/plain", "NOT_INITIALIZED"); return; }
      tcs3200MeasureRaw();
      tcs3200White[0] = tcs3200Last[0]; tcs3200White[1] = tcs3200Last[1]; tcs3200White[2] = tcs3200Last[2];
      server.send(200, "text/plain", "OK");
      return;
    }

    if (cmd.startsWith("TCS3200_CALIBRATE_BLACK")) {
      if (!tcs3200Ready) { server.send(400, "text/plain", "NOT_INITIALIZED"); return; }
      tcs3200MeasureRaw();
      tcs3200Black[0] = tcs3200Last[0]; tcs3200Black[1] = tcs3200Last[1]; tcs3200Black[2] = tcs3200Last[2];
      server.send(200, "text/plain", "OK");
      return;
    }

    if (cmd.startsWith("TCS3200_MEASURE")) {
      if (!tcs3200Ready) { server.send(400, "text/plain", "NOT_INITIALIZED"); return; }
      tcs3200MeasureRaw();
      server.send(200, "text/plain", "OK");
      return;
    }

    if (cmd.startsWith("TCS3200_GET_COLOR") || cmd.startsWith("TCS3200_RED") ||
        cmd.startsWith("TCS3200_GREEN") || cmd.startsWith("TCS3200_BLUE") ||
        cmd.startsWith("TCS3200_RGB")) {
      if (!tcs3200Ready) { server.send(400, "text/plain", "NOT_INITIALIZED"); return; }
      tcs3200MeasureRaw();
      int r = tcs3200MapChannel(0), g = tcs3200MapChannel(1), b = tcs3200MapChannel(2);
      if (cmd.startsWith("TCS3200_RGB")) {
        server.send(200, "text/plain", String(r) + " " + String(g) + " " + String(b));
      } else {
        char which[12] = "R";
        sscanf(cmd.c_str(), "TCS3200_GET_COLOR %11s", which);
        if (cmd.startsWith("TCS3200_GREEN") || which[0] == 'G' || which[0] == 'g') r = g;
        else if (cmd.startsWith("TCS3200_BLUE") || which[0] == 'B' || which[0] == 'b') r = b;
        else if (cmd.startsWith("TCS3200_RED") || which[0] == 'R' || which[0] == 'r') { /* r */ }
        server.send(200, "text/plain", String(r));
      }
      return;
    }

    // ================= MATRIX 8x8 INIT (MAX7219 SPI) =================
    if (cmd.startsWith("MATRIX8X8_INIT")) {
      int cs;
      if (sscanf(cmd.c_str(), "MATRIX8X8_INIT %d", &cs) == 1) {
        matrix8x8_cs_pin = cs;
        pinMode(matrix8x8_cs_pin, OUTPUT);
        digitalWrite(matrix8x8_cs_pin, HIGH);

        // Initialize SPI
        SPI.begin();

        // Initialize MAX7219
        max7219_send(MAX7219_REG_SHUTDOWN, 0x01);    // Turn on
        max7219_send(MAX7219_REG_DECODEMODE, 0x00);  // No decoding
        max7219_send(MAX7219_REG_SCANLIMIT, 0x07);   // Scan all digits
        max7219_send(MAX7219_REG_INTENSITY, 0x07);   // Medium brightness
        max7219_send(MAX7219_REG_DISPLAYTEST, 0x00); // Normal operation

        // Clear display
        for (int i = 0; i < 8; i++) {
          matrix8x8_buffer[i] = 0;
          max7219_send(MAX7219_REG_DIGIT0 + i, 0);
        }

        server.send(200, "text/plain", "OK");
      } else {
        server.send(400, "text/plain", "INVALID_FORMAT");
      }
      return;
    }

    // ================= MATRIX 8x8 PIXEL =================
    if (cmd.startsWith("MATRIX8X8_PIXEL")) {
      int x, y, color;
      if (sscanf(cmd.c_str(), "MATRIX8X8_PIXEL %d %d %d", &x, &y, &color) == 3 && matrix8x8_cs_pin >= 0) {
        if (x >= 0 && x < 8 && y >= 0 && y < 8) {
          if (color != 0) {
            matrix8x8_buffer[y] |= (1 << (7 - x));  // Set bit
          } else {
            matrix8x8_buffer[y] &= ~(1 << (7 - x)); // Clear bit
          }
          max7219_send(MAX7219_REG_DIGIT0 + y, matrix8x8_buffer[y]);
          server.send(200, "text/plain", "OK");
        } else {
          server.send(400, "text/plain", "OUT_OF_RANGE");
        }
      } else {
        server.send(400, "text/plain", "NOT_INITIALIZED");
      }
      return;
    }

    // ================= MATRIX 8x8 CLEAR =================
    if (cmd.startsWith("MATRIX8X8_CLEAR")) {
      if (matrix8x8_cs_pin >= 0) {
        for (int i = 0; i < 8; i++) {
          matrix8x8_buffer[i] = 0;
          max7219_send(MAX7219_REG_DIGIT0 + i, 0);
        }
        server.send(200, "text/plain", "OK");
      } else {
        server.send(400, "text/plain", "NOT_INITIALIZED");
      }
      return;
    }

    // ================= MATRIX 8x8 FILL =================
    if (cmd.startsWith("MATRIX8X8_FILL")) {
      int color;
      if (sscanf(cmd.c_str(), "MATRIX8X8_FILL %d", &color) == 1 && matrix8x8_cs_pin >= 0) {
        for (int i = 0; i < 8; i++) {
          matrix8x8_buffer[i] = (color != 0) ? 0xFF : 0x00;
          max7219_send(MAX7219_REG_DIGIT0 + i, matrix8x8_buffer[i]);
        }
        server.send(200, "text/plain", "OK");
      } else {
        server.send(400, "text/plain", "NOT_INITIALIZED");
      }
      return;
    }

    // ================= MATRIX 8x8 BRIGHTNESS =================
    if (cmd.startsWith("MATRIX8X8_BRIGHTNESS")) {
      int brt;
      if (sscanf(cmd.c_str(), "MATRIX8X8_BRIGHTNESS %d", &brt) == 1 && matrix8x8_cs_pin >= 0) {
        int intensity = constrain(brt, 0, 15);
        max7219_send(MAX7219_REG_INTENSITY, intensity);
        server.send(200, "text/plain", "OK");
      } else {
        server.send(400, "text/plain", "NOT_INITIALIZED");
      }
      return;
    }

    // ================= MATRIX 8x8 PATTERN =================
    if (cmd.startsWith("MATRIX8X8_PATTERN")) {
      char pattern[9];
      if (sscanf(cmd.c_str(), "MATRIX8X8_PATTERN %s", pattern) == 1 && matrix8x8_cs_pin >= 0) {
        for (int i = 0; i < 8 && i < strlen(pattern); i++) {
          uint8_t row = 0;
          for (int j = 0; j < 8; j++) {
            if (pattern[i] & (1 << j)) {
              row |= (1 << (7 - j));
            }
          }
          matrix8x8_buffer[i] = row;
          max7219_send(MAX7219_REG_DIGIT0 + i, row);
        }
        server.send(200, "text/plain", "OK");
      } else {
        server.send(400, "text/plain", "NOT_INITIALIZED");
      }
      return;
    }

    // ================= LED MATRIX INIT (NeoPixel 5x7) =================
    if (cmd.startsWith("LEDMATRIX_INIT")) {
      int pin, num, brt;
      if (sscanf(cmd.c_str(), "LEDMATRIX_INIT %d %d %d", &pin, &num, &brt) == 3) {
        if (ledMatrixStrip != nullptr) { delete ledMatrixStrip; }
        int n = (num > 0 && num <= 256) ? num : LEDMATRIX_LEDS;
        ledMatrixStrip = new Adafruit_NeoPixel(n, pin, NEO_GRB + NEO_KHZ800);
        ledMatrixStrip->begin();
        ledMatrixStrip->setBrightness(constrain(brt, 0, 255));
        ledMatrixStrip->show();
        server.send(200, "text/plain", "OK");
      } else {
        server.send(400, "text/plain", "INVALID_FORMAT");
      }
      return;
    }

    // ================= LED MATRIX PIXEL (5x7) =================
    if (cmd.startsWith("LEDMATRIX_PIXEL")) {
      int x, y, r, g, b;
      if (sscanf(cmd.c_str(), "LEDMATRIX_PIXEL %d %d %d %d %d", &x, &y, &r, &g, &b) == 5 && ledMatrixStrip != nullptr) {
        if (x >= 0 && x < LEDMATRIX_COLS && y >= 0 && y < LEDMATRIX_ROWS) {
          uint32_t color = ledMatrixStrip->Color(r, g, b);
          setMatrixPixel(x, y, color);
          ledMatrixStrip->show();
          server.send(200, "text/plain", "OK");
        } else {
          server.send(400, "text/plain", "OUT_OF_RANGE");
        }
      } else {
        server.send(400, "text/plain", "NOT_INITIALIZED");
      }
      return;
    }

    // ================= LED MATRIX CLEAR (5x7) =================
    if (cmd.startsWith("LEDMATRIX_CLEAR")) {
      if (ledMatrixStrip != nullptr) {
        for (int i = 0; i < ledMatrixStrip->numPixels(); i++) {
          ledMatrixStrip->setPixelColor(i, 0);
        }
        ledMatrixStrip->show();
        server.send(200, "text/plain", "OK");
      } else {
        server.send(400, "text/plain", "NOT_INITIALIZED");
      }
      return;
    }

    // ================= LED MATRIX CUSTOM (35-char pattern 5x7) =================
    if (cmd.startsWith("LEDMATRIX_CUSTOM")) {
      if (ledMatrixStrip == nullptr) {
        server.send(400, "text/plain", "NOT_INITIALIZED");
        return;
      }
      int idx = cmd.indexOf(" ");
      if (idx < 0) { server.send(400, "text/plain", "INVALID_FORMAT"); return; }
      String pattern = cmd.substring(idx + 1);
      pattern.trim();
      int len = pattern.length();
      int nLeds = ledMatrixStrip->numPixels();
      uint32_t onColor = ledMatrixStrip->Color(255, 255, 255);
      uint32_t offColor = ledMatrixStrip->Color(0, 0, 0);
      for (int i = 0; i < nLeds && i < len; i++) {
        uint32_t c = (pattern[i] == '1') ? onColor : offColor;
        ledMatrixStrip->setPixelColor(i, c);
      }
      for (int i = len; i < nLeds; i++) ledMatrixStrip->setPixelColor(i, offColor);
      ledMatrixStrip->show();
      server.send(200, "text/plain", "OK");
      return;
    }

    // ================= LED MATRIX TEXT (5x7) =================
    if (cmd.startsWith("LEDMATRIX_TEXT")) {
      char text[50];
      int r, g, b;
      if (sscanf(cmd.c_str(), "LEDMATRIX_TEXT %s %d %d %d", text, &r, &g, &b) >= 1 && ledMatrixStrip != nullptr) {
        uint32_t color = ledMatrixStrip->Color(r, g, b);
        matrixShowCharacter(toupper(text[0]), color);
        server.send(200, "text/plain", "OK");
      } else {
        server.send(400, "text/plain", "NOT_INITIALIZED");
      }
      return;
    }

    if (cmd.startsWith("LEDMATRIX_DIGIT") || cmd.startsWith("LED_SHOW_DIGIT")) {
      int digit;
      int parsed = cmd.startsWith("LEDMATRIX_DIGIT")
        ? sscanf(cmd.c_str(), "LEDMATRIX_DIGIT %d", &digit)
        : sscanf(cmd.c_str(), "LED_SHOW_DIGIT %d", &digit);
      if (parsed == 1 && ledMatrixStrip != nullptr) {
        matrixShowCharacter('0' + constrain(digit, 0, 9), ledMatrixStrip->Color(255, 255, 0));
        server.send(200, "text/plain", "OK");
      } else {
        server.send(400, "text/plain", "NOT_INITIALIZED");
      }
      return;
    }

    if (cmd.startsWith("LEDMATRIX_CHAR") || cmd.startsWith("LED_SHOW_CHAR")) {
      char character;
      int parsed = cmd.startsWith("LEDMATRIX_CHAR")
        ? sscanf(cmd.c_str(), "LEDMATRIX_CHAR %c", &character)
        : sscanf(cmd.c_str(), "LED_SHOW_CHAR %c", &character);
      if (parsed == 1 && ledMatrixStrip != nullptr) {
        matrixShowCharacter(toupper(character), ledMatrixStrip->Color(0, 255, 0));
        server.send(200, "text/plain", "OK");
      } else {
        server.send(400, "text/plain", "NOT_INITIALIZED");
      }
      return;
    }

    if (cmd.startsWith("LEDMATRIX_SYMBOL") || cmd.startsWith("LED_SHOW_SYMBOL")) {
      char symbol[16];
      int parsed = cmd.startsWith("LEDMATRIX_SYMBOL")
        ? sscanf(cmd.c_str(), "LEDMATRIX_SYMBOL %15s", symbol)
        : sscanf(cmd.c_str(), "LED_SHOW_SYMBOL %15s", symbol);
      if (parsed == 1 && ledMatrixStrip != nullptr) {
        char symbolCode = (strcasecmp(symbol, "Heart") == 0 || strcasecmp(symbol, "HEART") == 0) ? '*' : ':';
        matrixShowCharacter(symbolCode, ledMatrixStrip->Color(255, 0, 0));
        server.send(200, "text/plain", "OK");
      } else {
        server.send(400, "text/plain", "NOT_INITIALIZED");
      }
      return;
    }

    // ================= LCD I2C (1602) =================
    if (cmd.startsWith("LCD_INIT_EX")) {
      int addr, cols, rows, sda, scl;
      if (sscanf(cmd.c_str(), "LCD_INIT_EX %i %d %d %d %d", &addr, &cols, &rows, &sda, &scl) == 5 &&
          cols > 0 && rows > 0) {
        if (lcdDoInit(addr, cols, rows, sda, scl)) {
          server.send(200, "text/plain", "OK");
        } else {
          server.send(400, "text/plain", "INIT_FAILED");
        }
      } else {
        server.send(400, "text/plain", "INVALID_FORMAT");
      }
      return;
    }

    if (cmd.startsWith("LCD_INIT_I2C")) {
      int no, addr, chip;
      if (sscanf(cmd.c_str(), "LCD_INIT_I2C %d %i %d", &no, &addr, &chip) == 3) {
        int cols = chip == 2004 ? 20 : 16;
        int rows = chip == 2004 ? 4 : 2;
        if (lcdDoInit(addr, cols, rows, 21, 22)) {
          server.send(200, "text/plain", "LCD_OK");
        } else {
          server.send(400, "text/plain", "ERR:LCD_I2C");
        }
      } else {
        server.send(400, "text/plain", "INVALID_FORMAT");
      }
      return;
    }

    if (cmd.startsWith("LCD_INIT_STD")) {
      int no, rs, e, d4, d5, d6, d7;
      if (sscanf(cmd.c_str(), "LCD_INIT_STD %d %d %d %d %d %d %d", &no, &rs, &e, &d4, &d5, &d6, &d7) == 7) {
        lcdStdInit(rs, e, d4, d5, d6, d7);
        server.send(200, "text/plain", "LCD_OK");
      } else {
        server.send(400, "text/plain", "INVALID_FORMAT");
      }
      return;
    }

    if (cmd.startsWith("LCD_CURSOR")) {
      int no, col, row;
      if (sscanf(cmd.c_str(), "LCD_CURSOR %d %d %d", &no, &col, &row) == 3 && lcdAnyReady()) {
        if (lcdReady && lcdI2c != nullptr) lcdI2c->setCursor(col, row);
        else if (lcdStdReady) lcdStdCmd((uint8_t)(row == 0 ? 0x80 + col : 0xC0 + col));
        server.send(200, "text/plain", "OK");
      } else {
        server.send(400, "text/plain", "NOT_INITIALIZED");
      }
      return;
    }

    if (cmd.startsWith("LCD_PRINT_NUMBER")) {
      int no;
      float value;
      if (sscanf(cmd.c_str(), "LCD_PRINT_NUMBER %d %f", &no, &value) == 2 && lcdAnyReady()) {
        lcdWriteText(String(value));
        server.send(200, "text/plain", "OK");
      } else {
        server.send(400, "text/plain", "NOT_INITIALIZED");
      }
      return;
    }

    if (cmd.startsWith("LCD_PRINT_CHAR")) {
      int no, code;
      if (sscanf(cmd.c_str(), "LCD_PRINT_CHAR %d %d", &no, &code) == 2 && lcdAnyReady()) {
        if (lcdReady && lcdI2c != nullptr) lcdI2c->write((uint8_t)code);
        else if (lcdStdReady) lcdStdData((uint8_t)code);
        server.send(200, "text/plain", "OK");
      } else {
        server.send(400, "text/plain", "NOT_INITIALIZED");
      }
      return;
    }

    if (cmd.startsWith("LCD_PRINT")) {
      if (lcdAnyReady()) {
        int sp = cmd.indexOf(' ');
        if (sp > 0) {
          String rest = cmd.substring(sp + 1);
          rest.trim();
          int sp2 = rest.indexOf(' ');
          if (sp2 > 0) {
            String text = rest.substring(sp2 + 1);
            text.trim();
            lcdWriteText(text);
            server.send(200, "text/plain", "OK");
            return;
          }
        }
        server.send(400, "text/plain", "INVALID_FORMAT");
      } else {
        server.send(400, "text/plain", "NOT_INITIALIZED");
      }
      return;
    }

    if (cmd.startsWith("LCD_CLEAR")) {
      if (lcdAnyReady()) {
        if (lcdReady && lcdI2c != nullptr) lcdI2c->clear();
        else if (lcdStdReady) { lcdStdCmd(0x01); delay(2); }
        server.send(200, "text/plain", "OK");
      } else {
        server.send(400, "text/plain", "NOT_INITIALIZED");
      }
      return;
    }

    if (cmd.startsWith("LCD_BACKLIGHT")) {
      int no, state;
      if (sscanf(cmd.c_str(), "LCD_BACKLIGHT %d %d", &no, &state) == 2 && lcdEnsureReady()) {
        if (state) lcdI2c->backlight();
        else lcdI2c->noBacklight();
        server.send(200, "text/plain", "OK");
      } else {
        server.send(400, "text/plain", "NOT_INITIALIZED");
      }
      return;
    }

    if (cmd.startsWith("LCD_ACTION")) {
      int no;
      char action[20];
      if (sscanf(cmd.c_str(), "LCD_ACTION %d %s", &no, action) == 2 && lcdEnsureReady()) {
        if (strcmp(action, "home") == 0) lcdI2c->home();
        else if (strcmp(action, "display") == 0) lcdI2c->display();
        else if (strcmp(action, "noDisplay") == 0) lcdI2c->noDisplay();
        else if (strcmp(action, "cursor") == 0) lcdI2c->cursor();
        else if (strcmp(action, "noCursor") == 0) lcdI2c->noCursor();
        else if (strcmp(action, "blink") == 0) lcdI2c->blink();
        else if (strcmp(action, "noBlink") == 0) lcdI2c->noBlink();
        else if (strcmp(action, "scrollLeft") == 0) lcdI2c->scrollDisplayLeft();
        else if (strcmp(action, "scrollRight") == 0) lcdI2c->scrollDisplayRight();
        server.send(200, "text/plain", "OK");
      } else {
        server.send(400, "text/plain", "NOT_INITIALIZED");
      }
      return;
    }

    // ================= OLED SSD1306 =================
    if (cmd.startsWith("OLED_INIT")) {
      int width, height, address;
      char power[30];
      if (sscanf(cmd.c_str(), "OLED_INIT %d %d %i %29s", &width, &height, &address, power) == 4) {
        int powerMode = !strcasecmp(power, "SSD1306_EXTERNALVCC") || !strcasecmp(power, "external")
          ? SSD1306_EXTERNALVCC : SSD1306_SWITCHCAPVCC;
        if (oledDoInit(width, height, address, powerMode)) {
          server.send(200, "text/plain", "OK");
        } else {
          server.send(400, "text/plain", "INIT_FAILED");
        }
      } else {
        server.send(400, "text/plain", "INVALID_FORMAT");
      }
      return;
    }

    if (cmd.startsWith("OLED_PIXEL")) {
      int x, y;
      char color[20];
      if (sscanf(cmd.c_str(), "OLED_PIXEL %d %d %19s", &x, &y, color) == 3 && oledReady) {
        oledDisplay->drawPixel(x, y, oledColorFromText(color));
        oledRefresh();
        server.send(200, "text/plain", "OK");
      } else server.send(400, "text/plain", "NOT_INITIALIZED");
      return;
    }

    if (cmd.startsWith("OLED_LINE")) {
      int x0, y0, x1, y1;
      char color[20];
      if (sscanf(cmd.c_str(), "OLED_LINE %d %d %d %d %19s", &x0, &y0, &x1, &y1, color) == 5 && oledReady) {
        oledDisplay->drawLine(x0, y0, x1, y1, oledColorFromText(color));
        oledRefresh();
        server.send(200, "text/plain", "OK");
      } else server.send(400, "text/plain", "NOT_INITIALIZED");
      return;
    }

    if (cmd.startsWith("OLED_FILL_RECT")) {
      int x, y, width, height;
      char color[20];
      if (sscanf(cmd.c_str(), "OLED_FILL_RECT %d %d %d %d %19s", &x, &y, &width, &height, color) == 5 && oledReady) {
        oledDisplay->fillRect(x, y, width, height, oledColorFromText(color));
        oledRefresh();
        server.send(200, "text/plain", "OK");
      } else server.send(400, "text/plain", "NOT_INITIALIZED");
      return;
    }

    if (cmd.startsWith("OLED_RECT")) {
      int x, y, width, height;
      char color[20];
      if (sscanf(cmd.c_str(), "OLED_RECT %d %d %d %d %19s", &x, &y, &width, &height, color) == 5 && oledReady) {
        oledDisplay->drawRect(x, y, width, height, oledColorFromText(color));
        oledRefresh();
        server.send(200, "text/plain", "OK");
      } else server.send(400, "text/plain", "NOT_INITIALIZED");
      return;
    }

    if (cmd.startsWith("OLED_FILL_CIRCLE")) {
      int x, y, radius;
      char color[20];
      if (sscanf(cmd.c_str(), "OLED_FILL_CIRCLE %d %d %d %19s", &x, &y, &radius, color) == 4 && oledReady) {
        oledDisplay->fillCircle(x, y, radius, oledColorFromText(color));
        oledRefresh();
        server.send(200, "text/plain", "OK");
      } else server.send(400, "text/plain", "NOT_INITIALIZED");
      return;
    }

    if (cmd.startsWith("OLED_CIRCLE")) {
      int x, y, radius;
      char color[20];
      if (sscanf(cmd.c_str(), "OLED_CIRCLE %d %d %d %19s", &x, &y, &radius, color) == 4 && oledReady) {
        oledDisplay->drawCircle(x, y, radius, oledColorFromText(color));
        oledRefresh();
        server.send(200, "text/plain", "OK");
      } else server.send(400, "text/plain", "NOT_INITIALIZED");
      return;
    }

    if (cmd.startsWith("OLED_FILL_ROUND_RECT")) {
      int x, y, width, height, radius;
      char color[20];
      if (sscanf(cmd.c_str(), "OLED_FILL_ROUND_RECT %d %d %d %d %d %19s",
          &x, &y, &width, &height, &radius, color) == 6 && oledReady) {
        oledDisplay->fillRoundRect(x, y, width, height, radius, oledColorFromText(color));
        oledRefresh();
        server.send(200, "text/plain", "OK");
      } else server.send(400, "text/plain", "NOT_INITIALIZED");
      return;
    }

    if (cmd.startsWith("OLED_ROUND_RECT")) {
      int x, y, width, height, radius;
      char color[20];
      if (sscanf(cmd.c_str(), "OLED_ROUND_RECT %d %d %d %d %d %19s",
          &x, &y, &width, &height, &radius, color) == 6 && oledReady) {
        oledDisplay->drawRoundRect(x, y, width, height, radius, oledColorFromText(color));
        oledRefresh();
        server.send(200, "text/plain", "OK");
      } else server.send(400, "text/plain", "NOT_INITIALIZED");
      return;
    }

    if (cmd.startsWith("OLED_FILL_TRIANGLE")) {
      int x0, y0, x1, y1, x2, y2;
      char color[20];
      if (sscanf(cmd.c_str(), "OLED_FILL_TRIANGLE %d %d %d %d %d %d %19s",
          &x0, &y0, &x1, &y1, &x2, &y2, color) == 7 && oledReady) {
        oledDisplay->fillTriangle(x0, y0, x1, y1, x2, y2, oledColorFromText(color));
        oledRefresh();
        server.send(200, "text/plain", "OK");
      } else server.send(400, "text/plain", "NOT_INITIALIZED");
      return;
    }

    if (cmd.startsWith("OLED_TRIANGLE")) {
      int x0, y0, x1, y1, x2, y2;
      char color[20];
      if (sscanf(cmd.c_str(), "OLED_TRIANGLE %d %d %d %d %d %d %19s",
          &x0, &y0, &x1, &y1, &x2, &y2, color) == 7 && oledReady) {
        oledDisplay->drawTriangle(x0, y0, x1, y1, x2, y2, oledColorFromText(color));
        oledRefresh();
        server.send(200, "text/plain", "OK");
      } else server.send(400, "text/plain", "NOT_INITIALIZED");
      return;
    }

    if (cmd.startsWith("OLED_TEXT_STYLE")) {
      int size;
      char color[20], background[20];
      if (sscanf(cmd.c_str(), "OLED_TEXT_STYLE %d %19s %19s", &size, color, background) == 3 && oledReady) {
        oledDisplay->setTextSize(max(1, size));
        oledDisplay->setTextColor(oledColorFromText(color), oledColorFromText(background));
        server.send(200, "text/plain", "OK");
      } else server.send(400, "text/plain", "NOT_INITIALIZED");
      return;
    }

    if (cmd.startsWith("OLED_TEXT_SIZE")) {
      int size;
      if (sscanf(cmd.c_str(), "OLED_TEXT_SIZE %d", &size) == 1 && oledReady) {
        oledDisplay->setTextSize(max(1, size));
        server.send(200, "text/plain", "OK");
      } else server.send(400, "text/plain", "NOT_INITIALIZED");
      return;
    }

    if (cmd.startsWith("OLED_FONT")) {
      char font[30];
      if (sscanf(cmd.c_str(), "OLED_FONT %29s", font) == 1 && oledReady && oledSetFontByName(font)) {
        server.send(200, "text/plain", "OK");
      } else server.send(400, "text/plain", "INVALID_FONT");
      return;
    }

    if (cmd.startsWith("OLED_CURSOR")) {
      int x, y;
      if (sscanf(cmd.c_str(), "OLED_CURSOR %d %d", &x, &y) == 2 && oledReady) {
        oledDisplay->setCursor(x, y);
        server.send(200, "text/plain", "OK");
      } else server.send(400, "text/plain", "NOT_INITIALIZED");
      return;
    }

    if (cmd.startsWith("OLED_PRINT")) {
      char color[20], background[20];
      int newLine;
      int consumed = 0;
      if (sscanf(cmd.c_str(), "OLED_PRINT %19s %19s %d %n", color, background, &newLine, &consumed) == 3 &&
          oledReady && consumed > 0) {
        String text = cmd.substring(consumed);
        oledDisplay->setTextColor(oledColorFromText(color), oledColorFromText(background));
        if (newLine) oledDisplay->println(text);
        else oledDisplay->print(text);
        oledRefresh();
        server.send(200, "text/plain", "OK");
      } else server.send(400, "text/plain", "INVALID_FORMAT");
      return;
    }

    if (cmd.startsWith("OLED_CLEAR")) {
      if (oledReady) {
        oledDisplay->clearDisplay();
        oledRefresh();
        server.send(200, "text/plain", "OK");
      } else server.send(400, "text/plain", "NOT_INITIALIZED");
      return;
    }

    if (cmd.startsWith("OLED_REFRESH")) {
      if (oledReady) {
        oledRefresh();
        server.send(200, "text/plain", "OK");
      } else server.send(400, "text/plain", "NOT_INITIALIZED");
      return;
    }

    if (cmd.startsWith("OLED_INVERT")) {
      char state[8];
      if (sscanf(cmd.c_str(), "OLED_INVERT %7s", state) == 1 && oledReady) {
        bool enabled = !strcasecmp(state, "true") || !strcasecmp(state, "on") || !strcmp(state, "1");
        oledDisplay->invertDisplay(enabled);
        oledRefresh();
        server.send(200, "text/plain", "OK");
      } else server.send(400, "text/plain", "NOT_INITIALIZED");
      return;
    }

    if (cmd.startsWith("OLED_SCROLL_START")) {
      char direction[12];
      int y0, y1;
      if (sscanf(cmd.c_str(), "OLED_SCROLL_START %11s %d %d", direction, &y0, &y1) == 3 && oledReady) {
        if (!strcasecmp(direction, "right")) oledDisplay->startscrollright(y0, y1);
        else if (!strcasecmp(direction, "left")) oledDisplay->startscrollleft(y0, y1);
        else if (!strcasecmp(direction, "diagright")) oledDisplay->startscrolldiagright(y0, y1);
        else if (!strcasecmp(direction, "diagleft")) oledDisplay->startscrolldiagleft(y0, y1);
        else {
          server.send(400, "text/plain", "INVALID_DIRECTION");
          return;
        }
        server.send(200, "text/plain", "OK");
      } else server.send(400, "text/plain", "NOT_INITIALIZED");
      return;
    }

    if (cmd.startsWith("OLED_SCROLL_STOP")) {
      if (oledReady) {
        oledDisplay->stopscroll();
        server.send(200, "text/plain", "OK");
      } else server.send(400, "text/plain", "NOT_INITIALIZED");
      return;
    }

    // ================= RGB LED (NeoPixel) =================
    if (cmd.startsWith("RGBLED_INIT")) {
      int portOrPin, rgbPin;
      int count = sscanf(cmd.c_str(), "RGBLED_INIT %d %d", &portOrPin, &rgbPin);
      if (count == 1) rgbPin = portOrPin;
      if (count == 2 && portOrPin >= 1 && portOrPin <= RGBLED_MAX_STRIPS) rgbLedPortPin[portOrPin] = rgbPin;
      if (count >= 1 && rgbLedGetEntry(rgbPin) != nullptr) {
        server.send(200, "text/plain", "OK");
      } else {
        server.send(400, "text/plain", count >= 1 ? "INIT_FAILED" : "INVALID_FORMAT");
      }
      return;
    }

    if (cmd.startsWith("RGBLED_SET_CHANNEL")) {
      int pin, channelValue;
      char channel[4];
      if (sscanf(cmd.c_str(), "RGBLED_SET_CHANNEL %d %3s %d", &pin, channel, &channelValue) == 3) {
        RgbLedEntry* px = rgbLedGetEntry(pin);
        if (px != nullptr) {
          channelValue = constrain(channelValue, 0, 255);
          if (channel[0] == 'R' || channel[0] == 'r') px->r = channelValue;
          else if (channel[0] == 'G' || channel[0] == 'g') px->g = channelValue;
          else if (channel[0] == 'B' || channel[0] == 'b') px->b = channelValue;
          else { server.send(400, "text/plain", "INVALID_CHANNEL"); return; }
          rgbLedApply(px);
          server.send(200, "text/plain", "OK");
        } else {
          server.send(400, "text/plain", "NOT_INITIALIZED");
        }
      } else {
        server.send(400, "text/plain", "INVALID_FORMAT");
      }
      return;
    }

    if (cmd.startsWith("RGBLED_CHANGE_CHANNEL")) {
      int pin, delta;
      char channel[4];
      if (sscanf(cmd.c_str(), "RGBLED_CHANGE_CHANNEL %d %3s %d", &pin, channel, &delta) == 3) {
        RgbLedEntry* px = rgbLedGetEntry(pin);
        if (px != nullptr) {
          if (channel[0] == 'R' || channel[0] == 'r') px->r = constrain((int)px->r + delta, 0, 255);
          else if (channel[0] == 'G' || channel[0] == 'g') px->g = constrain((int)px->g + delta, 0, 255);
          else if (channel[0] == 'B' || channel[0] == 'b') px->b = constrain((int)px->b + delta, 0, 255);
          else { server.send(400, "text/plain", "INVALID_CHANNEL"); return; }
          rgbLedApply(px);
          server.send(200, "text/plain", "OK");
        } else {
          server.send(400, "text/plain", "NOT_INITIALIZED");
        }
      } else {
        server.send(400, "text/plain", "INVALID_FORMAT");
      }
      return;
    }

    if (cmd.startsWith("RGBLED_GET_CHANNEL") || cmd.startsWith("RGBLED_GET")) {
      int pin;
      char channel[4];
      int parsed = cmd.startsWith("RGBLED_GET_CHANNEL")
        ? sscanf(cmd.c_str(), "RGBLED_GET_CHANNEL %d %3s", &pin, channel)
        : sscanf(cmd.c_str(), "RGBLED_GET %d %3s", &pin, channel);
      if (parsed == 2) {
        RgbLedEntry* px = rgbLedGetEntry(pin);
        if (px != nullptr) {
          int value = px->r;
          if (channel[0] == 'G' || channel[0] == 'g') value = px->g;
          else if (channel[0] == 'B' || channel[0] == 'b') value = px->b;
          server.send(200, "text/plain", String(value));
        } else {
          server.send(400, "text/plain", "NOT_INITIALIZED");
        }
      } else {
        server.send(400, "text/plain", "INVALID_FORMAT");
      }
      return;
    }

    if (cmd.startsWith("RGBLED_SET_FOR")) {
      int pin, r, g, b;
      char secondsText[16];
      if (sscanf(cmd.c_str(), "RGBLED_SET_FOR %d %d %d %d %15s", &pin, &r, &g, &b, secondsText) == 5) {
        RgbLedEntry* px = rgbLedGetEntry(pin);
        if (px != nullptr) {
          px->r = constrain(r, 0, 255);
          px->g = constrain(g, 0, 255);
          px->b = constrain(b, 0, 255);
          rgbLedApply(px);
          delay((unsigned long)(String(secondsText).toFloat() * 1000.0f));
          px->r = px->g = px->b = 0;
          rgbLedApply(px);
          server.send(200, "text/plain", "OK");
        } else {
          server.send(400, "text/plain", "NOT_INITIALIZED");
        }
      } else {
        server.send(400, "text/plain", "INVALID_FORMAT");
      }
      return;
    }

    if (cmd.startsWith("RGBLED_HEX")) {
      int pin;
      char colourText[16];
      if (sscanf(cmd.c_str(), "RGBLED_HEX %d %15s", &pin, colourText) == 2) {
        RgbLedEntry* px = rgbLedGetEntry(pin);
        if (px != nullptr) {
          char* start = colourText[0] == '#' ? colourText + 1 : colourText;
          unsigned long colour = strtoul(start, NULL, 16);
          px->r = (colour >> 16) & 0xFF;
          px->g = (colour >> 8) & 0xFF;
          px->b = colour & 0xFF;
          rgbLedApply(px);
          server.send(200, "text/plain", "OK");
        } else {
          server.send(400, "text/plain", "NOT_INITIALIZED");
        }
      } else {
        server.send(400, "text/plain", "INVALID_FORMAT");
      }
      return;
    }

    if (cmd.startsWith("RGBLED_SET")) {
      int pin, r, g, b;
      if (sscanf(cmd.c_str(), "RGBLED_SET %d %d %d %d", &pin, &r, &g, &b) == 4) {
        RgbLedEntry* px = rgbLedGetEntry(pin);
        if (px != nullptr) {
          px->r = constrain(r, 0, 255);
          px->g = constrain(g, 0, 255);
          px->b = constrain(b, 0, 255);
          rgbLedApply(px);
          server.send(200, "text/plain", "OK");
        } else {
          server.send(400, "text/plain", "NOT_INITIALIZED");
        }
      } else {
        server.send(400, "text/plain", "INVALID_FORMAT");
      }
      return;
    }

    if (cmd.startsWith("RGBLED_OFF")) {
      int pin;
      if (sscanf(cmd.c_str(), "RGBLED_OFF %d", &pin) == 1) {
        RgbLedEntry* px = rgbLedGetEntry(pin);
        if (px != nullptr) {
          px->r = px->g = px->b = 0;
          rgbLedApply(px);
          server.send(200, "text/plain", "OK");
        } else {
          server.send(400, "text/plain", "NOT_INITIALIZED");
        }
      } else {
        server.send(400, "text/plain", "INVALID_FORMAT");
      }
      return;
    }

    // ================= ROTARY ENCODER =================
    if (cmd.startsWith("ENCODER_INIT")) {
      int clk, dt, sw = -1;
      int parsed = sscanf(cmd.c_str(), "ENCODER_INIT %d %d %d", &clk, &dt, &sw);
      if (parsed >= 2) {
        encInitPins(clk, dt, parsed == 3 ? sw : -1);
        server.send(200, "text/plain", "OK");
      } else {
        server.send(400, "text/plain", "INVALID_FORMAT");
      }
      return;
    }

    if (cmd.startsWith("ENCODER_CONNECT_BUTTON")) {
      int sw;
      if (sscanf(cmd.c_str(), "ENCODER_CONNECT_BUTTON %d", &sw) == 1) {
        encSwPin = sw;
        if (sw >= 0) {
#if defined(ARDUINO_ARCH_ESP32)
          pinMode(encSwPin, (encSwPin >= 34 && encSwPin <= 39) ? INPUT : INPUT_PULLUP);
#else
          pinMode(encSwPin, INPUT_PULLUP);
#endif
        }
        server.send(200, "text/plain", "OK");
      } else {
        server.send(400, "text/plain", "INVALID_FORMAT");
      }
      return;
    }

    if (cmd.startsWith("ENCODER_GET_COUNT")) {
      if (encInitialized) {
        server.send(200, "text/plain", String(encGetCountForApp()));
      } else {
        server.send(400, "text/plain", "NOT_INITIALIZED");
      }
      return;
    }

    if (cmd.startsWith("ENCODER_RESET")) {
      if (encInitialized) {
        encReset();
        server.send(200, "text/plain", "OK");
      } else {
        server.send(400, "text/plain", "NOT_INITIALIZED");
      }
      return;
    }

    if (cmd.startsWith("ENCODER_GET_DIRECTION")) {
      if (encInitialized) {
        server.send(200, "text/plain", encGetDirectionStr());
      } else {
        server.send(400, "text/plain", "NOT_INITIALIZED");
      }
      return;
    }

    if (cmd.startsWith("ENCODER_GET_SPEED")) {
      if (encInitialized) {
        server.send(200, "text/plain", String(encGetSpeed()));
      } else {
        server.send(400, "text/plain", "NOT_INITIALIZED");
      }
      return;
    }

    if (cmd.startsWith("ENCODER_BUTTON_CONNECT") || cmd.startsWith("ENCODER_BUTTON_LISTEN")) {
      if (encInitialized) {
        encButtonListening = true;
        encButtonPrevious = encButtonPressed();
        server.send(200, "text/plain", "OK");
      } else {
        server.send(400, "text/plain", "NOT_INITIALIZED");
      }
      return;
    }

    if (cmd.startsWith("ENCODER_BUTTON_STATE")) {
      if (encInitialized) {
        server.send(200, "text/plain", String(digitalRead(encSwPin)));
      } else {
        server.send(400, "text/plain", "NOT_INITIALIZED");
      }
      return;
    }

    if (cmd.startsWith("ENCODER_BUTTON_PRESSED")) {
      if (encInitialized) {
        server.send(200, "text/plain", encButtonPressed() ? "1" : "0");
      } else {
        server.send(400, "text/plain", "NOT_INITIALIZED");
      }
      return;
    }

    if (cmd.startsWith("ENCODER_BUTTON_EVENT")) {
      if (encInitialized && encButtonListening) {
        bool pressed = encButtonPressed();
        bool event = pressed && !encButtonPrevious;
        encButtonPrevious = pressed;
        server.send(200, "text/plain", event ? "1" : "0");
      } else {
        server.send(400, "text/plain", "NOT_LISTENING");
      }
      return;
    }

    // ================= PS2 JOYSTICK =================
    if (cmd.startsWith("JOYSTICK_INIT")) {
      int no, xPin, yPin, swPin = -1;
      char xText[12], yText[12], swText[12];
      int parsed = sscanf(cmd.c_str(), "JOYSTICK_INIT %d %11s %11s %11s", &no, xText, yText, swText);
      if (parsed >= 3 && no >= 0 && no < JOYSTICK_MAX) {
        xPin = parseWifiPin(xText);
        yPin = parseWifiPin(yText);
        swPin = parsed == 4 ? parseWifiPin(swText) : -1;
        joystickXPin[no] = xPin;
        joystickYPin[no] = yPin;
        joystickSwPin[no] = swPin;
        pinMode(xPin, INPUT);
        pinMode(yPin, INPUT);
#if defined(ARDUINO_ARCH_ESP32)
        analogReadResolution(12);
        analogSetPinAttenuation(xPin, ADC_11db);
        analogSetPinAttenuation(yPin, ADC_11db);
        if (swPin >= 0) pinMode(swPin, (swPin >= 34 && swPin <= 39) ? INPUT : INPUT_PULLUP);
#else
        if (swPin >= 0) pinMode(swPin, INPUT_PULLUP);
#endif
        delay(30);
        long sumX = 0, sumY = 0;
        for (int i = 0; i < 8; i++) {
          delay(5);
          sumX += analogRead(xPin);
          sumY += analogRead(yPin);
        }
        joystickCenterX[no] = sumX / 8;
        joystickCenterY[no] = sumY / 8;
        server.send(200, "text/plain", "OK");
      } else {
        server.send(400, "text/plain", "INVALID_FORMAT");
      }
      return;
    }

    if (cmd.startsWith("JOYSTICK_AXIS")) {
      int no, mapped;
      char axis[2];
      if (sscanf(cmd.c_str(), "JOYSTICK_AXIS %d %1s %d", &no, axis, &mapped) == 3 && joystickValid(no)) {
        server.send(200, "text/plain", String(joystickReadAxis(no, axis[0] == 'Y', mapped != 0)));
      } else {
        server.send(400, "text/plain", "NOT_INITIALIZED");
      }
      return;
    }

    if (cmd.startsWith("JOYSTICK_DIRECTION_IS")) {
      int no;
      char target[10];
      if (sscanf(cmd.c_str(), "JOYSTICK_DIRECTION_IS %d %9s", &no, target) == 2 && joystickValid(no)) {
        String expected = String(target);
        expected.toUpperCase();
        server.send(200, "text/plain", joystickDirection(no) == expected ? "1" : "0");
      } else {
        server.send(400, "text/plain", "NOT_INITIALIZED");
      }
      return;
    }

    if (cmd.startsWith("JOYSTICK_DIRECTION")) {
      int no;
      if (sscanf(cmd.c_str(), "JOYSTICK_DIRECTION %d", &no) == 1 && joystickValid(no)) {
        server.send(200, "text/plain", joystickDirection(no));
      } else {
        server.send(400, "text/plain", "NOT_INITIALIZED");
      }
      return;
    }

    if (cmd.startsWith("JOYSTICK_ANGLE")) {
      int no;
      if (sscanf(cmd.c_str(), "JOYSTICK_ANGLE %d", &no) == 1 && joystickValid(no)) {
        server.send(200, "text/plain", String(joystickAngle(no)));
      } else {
        server.send(400, "text/plain", "NOT_INITIALIZED");
      }
      return;
    }

    if (cmd.startsWith("JOYSTICK_MAGNITUDE")) {
      int no;
      if (sscanf(cmd.c_str(), "JOYSTICK_MAGNITUDE %d", &no) == 1 && joystickValid(no)) {
        server.send(200, "text/plain", String(joystickMagnitude(no)));
      } else {
        server.send(400, "text/plain", "NOT_INITIALIZED");
      }
      return;
    }

    if (cmd.startsWith("JOYSTICK_BUTTON_STATE")) {
      int no;
      if (sscanf(cmd.c_str(), "JOYSTICK_BUTTON_STATE %d", &no) == 1 && joystickValid(no)) {
        server.send(200, "text/plain", String(digitalRead(joystickSwPin[no])));
      } else {
        server.send(400, "text/plain", "NOT_INITIALIZED");
      }
      return;
    }

    if (cmd.startsWith("JOYSTICK_BUTTON_PRESSED")) {
      int no;
      if (sscanf(cmd.c_str(), "JOYSTICK_BUTTON_PRESSED %d", &no) == 1 && joystickValid(no)) {
        server.send(200, "text/plain", joystickButtonPressed(no) ? "1" : "0");
      } else {
        server.send(400, "text/plain", "NOT_INITIALIZED");
      }
      return;
    }

    if (cmd.startsWith("JOYSTICK_DEADZONE")) {
      int no, value;
      if (sscanf(cmd.c_str(), "JOYSTICK_DEADZONE %d %d", &no, &value) == 2 && joystickValid(no)) {
        joystickDeadzone[no] = max(0, value);
        server.send(200, "text/plain", "OK");
      } else {
        server.send(400, "text/plain", "NOT_INITIALIZED");
      }
      return;
    }

    if (cmd.startsWith("JOYSTICK_THRESHOLDS")) {
      int no, low, high;
      if (sscanf(cmd.c_str(), "JOYSTICK_THRESHOLDS %d %d %d", &no, &low, &high) == 3 && joystickValid(no)) {
        joystickLowThreshold[no] = max(0, low);
        joystickHighThreshold[no] = max(joystickLowThreshold[no], high);
        server.send(200, "text/plain", "OK");
      } else {
        server.send(400, "text/plain", "NOT_INITIALIZED");
      }
      return;
    }

    if (cmd.startsWith("JOYSTICK_BUTTON_LISTEN")) {
      int no;
      if (sscanf(cmd.c_str(), "JOYSTICK_BUTTON_LISTEN %d", &no) == 1 && joystickValid(no)) {
        joystickListening[no] = true;
        joystickPreviousPressed[no] = joystickButtonPressed(no);
        server.send(200, "text/plain", "OK");
      } else {
        server.send(400, "text/plain", "NOT_INITIALIZED");
      }
      return;
    }

    if (cmd.startsWith("JOYSTICK_BUTTON_EVENT")) {
      int no;
      if (sscanf(cmd.c_str(), "JOYSTICK_BUTTON_EVENT %d", &no) == 1 &&
          joystickValid(no) && joystickListening[no]) {
        bool pressed = joystickButtonPressed(no);
        bool event = pressed && !joystickPreviousPressed[no];
        joystickPreviousPressed[no] = pressed;
        server.send(200, "text/plain", event ? "1" : "0");
      } else {
        server.send(400, "text/plain", "NOT_LISTENING");
      }
      return;
    }

    if (cmd.startsWith("PS2_READ")) {
      int xPin, yPin;
      if (sscanf(cmd.c_str(), "PS2_READ %d %d", &xPin, &yPin) == 2) {
        ps2EnsurePins(xPin, yPin, -1, -1, -1);
        int x = analogRead(xPin);
        int y = analogRead(yPin);
        int sw = (joystickSwPin[0] > 0) ? digitalRead(joystickSwPin[0]) : 1;
        server.send(200, "text/plain", "PS2 " + String(x) + " " + String(y) + " " + String(sw));
      } else {
        server.send(400, "text/plain", "INVALID_FORMAT");
      }
      return;
    }

    if (cmd.startsWith("PS2_DIRECTION")) {
      int xPin, yPin, cx, cy, dz;
      if (sscanf(cmd.c_str(), "PS2_DIRECTION %d %d %d %d %d", &xPin, &yPin, &cx, &cy, &dz) == 5) {
        int x = analogRead(xPin);
        int y = analogRead(yPin);
        server.send(200, "text/plain", ps2DirectionFrom(x, y, cx, cy, dz));
      } else {
        server.send(400, "text/plain", "INVALID_FORMAT");
      }
      return;
    }

    if (cmd.startsWith("PS2_ANGLE")) {
      int xPin, yPin, cx, cy, dz;
      if (sscanf(cmd.c_str(), "PS2_ANGLE %d %d %d %d %d", &xPin, &yPin, &cx, &cy, &dz) == 5) {
        int dx = analogRead(xPin) - cx;
        int dy = analogRead(yPin) - cy;
        if (abs(dx) <= dz && abs(dy) <= dz) {
          server.send(200, "text/plain", "0");
        } else {
          float angle = atan2f((float)dy, (float)dx) * 180.0f / 3.14159265f;
          if (angle < 0) angle += 360.0f;
          server.send(200, "text/plain", String((int)(angle + 0.5f)));
        }
      } else {
        server.send(400, "text/plain", "INVALID_FORMAT");
      }
      return;
    }

    if (cmd.startsWith("PS2_MAGNITUDE")) {
      int xPin, yPin, cx, cy, dz;
      if (sscanf(cmd.c_str(), "PS2_MAGNITUDE %d %d %d %d %d", &xPin, &yPin, &cx, &cy, &dz) == 5) {
        float dx = analogRead(xPin) - cx;
        float dy = analogRead(yPin) - cy;
        float mag = sqrtf(dx * dx + dy * dy);
        int pct = constrain((int)(mag / 2047.0f * 100.0f + 0.5f), 0, 100);
        if (mag < dz) pct = 0;
        server.send(200, "text/plain", String(pct));
      } else {
        server.send(400, "text/plain", "INVALID_FORMAT");
      }
      return;
    }

    if (cmd.startsWith("JOY_CONT_SERVO")) {
      int servoPin, analogPin, minA, maxA, dz, speed;
      if (sscanf(cmd.c_str(), "JOY_CONT_SERVO %d %d %d %d %d %d",
          &servoPin, &analogPin, &minA, &maxA, &dz, &speed) == 6) {
        int raw = analogRead(analogPin);
        int center = JOYSTICK_ADC_MAX / 2;
        int target;
        if (abs(raw - center) <= dz) target = (minA + maxA) / 2;
        else target = map(constrain(raw, 0, JOYSTICK_ADC_MAX), 0, JOYSTICK_ADC_MAX, minA, maxA);
        int step = max(1, speed);
        if (target > joyContLastAngle) joyContLastAngle = min(target, joyContLastAngle + step);
        else if (target < joyContLastAngle) joyContLastAngle = max(target, joyContLastAngle - step);
        __blockly_servo__.attach(servoPin);
        __blockly_servo__.write(joyContLastAngle);
        server.send(200, "text/plain", "OK");
      } else {
        server.send(400, "text/plain", "INVALID_FORMAT");
      }
      return;
    }

    if (cmd.startsWith("SERIAL_BEGIN")) {
      int no, baud;
      if (sscanf(cmd.c_str(), "SERIAL_BEGIN %d %d", &no, &baud) == 2) {
        wifiSerialPort(no)->begin(baud);
        server.send(200, "text/plain", "OK");
      } else {
        server.send(400, "text/plain", "INVALID_FORMAT");
      }
      return;
    }

    if (cmd.startsWith("SERIAL_PRINT")) {
      int no;
      int consumed = 0;
      if (sscanf(cmd.c_str(), "SERIAL_PRINT %d %n", &no, &consumed) >= 1 && consumed > 0) {
        String rest = cmd.substring(consumed);
        rest.trim();
        int lastSp = rest.lastIndexOf(' ');
        String value = rest;
        String eol = "warp";
        if (lastSp >= 0) {
          eol = rest.substring(lastSp + 1);
          value = rest.substring(0, lastSp);
        }
        if (eol == "warp") wifiSerialPort(no)->println(value);
        else wifiSerialPort(no)->print(value);
        server.send(200, "text/plain", "OK");
      } else {
        server.send(400, "text/plain", "INVALID_FORMAT");
      }
      return;
    }

    if (cmd.startsWith("SERIAL_AVAILABLE")) {
      int no;
      if (sscanf(cmd.c_str(), "SERIAL_AVAILABLE %d", &no) == 1) {
        server.send(200, "text/plain", String(wifiSerialPort(no)->available()));
      } else {
        server.send(400, "text/plain", "INVALID_FORMAT");
      }
      return;
    }

    if (cmd.startsWith("SERIAL_READ_BYTE")) {
      int no;
      if (sscanf(cmd.c_str(), "SERIAL_READ_BYTE %d", &no) == 1) {
        HardwareSerial* port = wifiSerialPort(no);
        int b = port->available() ? port->read() : -1;
        server.send(200, "text/plain", String(b));
      } else {
        server.send(400, "text/plain", "INVALID_FORMAT");
      }
      return;
    }

    if (cmd.startsWith("SERIAL_READ_STRING")) {
      int no;
      if (sscanf(cmd.c_str(), "SERIAL_READ_STRING %d", &no) == 1) {
        HardwareSerial* port = wifiSerialPort(no);
        String s = port->readString();
        s.trim();
        server.send(200, "text/plain", s);
      } else {
        server.send(400, "text/plain", "INVALID_FORMAT");
      }
      return;
    }

    // ================= VOLTAGE / CURRENT =================
    if (cmd.startsWith("VOLTAGE_INIT")) {
      char pinText[12], refText[16];
      if (sscanf(cmd.c_str(), "VOLTAGE_INIT %11s %15s", pinText, refText) == 2) {
        voltagePin = parseWifiPin(pinText);
        voltageReference = String(refText).toFloat();
        if (voltageReference <= 0) voltageReference = WIFI_ADC_VREF;
        pinMode(voltagePin, INPUT);
#if defined(ARDUINO_ARCH_ESP32)
        analogReadResolution(12);
        analogSetPinAttenuation(voltagePin, ADC_11db);
#endif
        server.send(200, "text/plain", "OK");
      } else {
        server.send(400, "text/plain", "INVALID_FORMAT");
      }
      return;
    }

    if (cmd.startsWith("VOLTAGE_READ_V")) {
      if (voltagePin < 0) server.send(400, "text/plain", "NOT_INITIALIZED");
      else server.send(200, "text/plain", String(readVoltageVout()));
      return;
    }

    if (cmd.startsWith("VOLTAGE_READ_RAW")) {
      if (voltagePin < 0) server.send(400, "text/plain", "NOT_INITIALIZED");
      else server.send(200, "text/plain", String(analogRead(voltagePin)));
      return;
    }

    if (cmd.startsWith("VOLTAGE_READ")) {
      char pinText[12];
      if (sscanf(cmd.c_str(), "VOLTAGE_READ %11s", pinText) == 1) {
        server.send(200, "text/plain", String(analogRead(parseWifiPin(pinText))));
      } else if (voltagePin >= 0) {
        server.send(200, "text/plain", String(analogRead(voltagePin)));
      } else {
        server.send(400, "text/plain", "INVALID_FORMAT");
      }
      return;
    }

    if (cmd.startsWith("CURRENT_INIT")) {
      char pinText[12], modelText[20];
      if (sscanf(cmd.c_str(), "CURRENT_INIT %11s %19s", pinText, modelText) == 2) {
        currentPin = parseWifiPin(pinText);
        currentSensitivity = currentSensitivityFrom(modelText);
        pinMode(currentPin, INPUT);
#if defined(ARDUINO_ARCH_ESP32)
        analogReadResolution(12);
        analogSetPinAttenuation(currentPin, ADC_11db);
#endif
        server.send(200, "text/plain", "OK");
      } else {
        server.send(400, "text/plain", "INVALID_FORMAT");
      }
      return;
    }

    if (cmd.startsWith("CURRENT_READ_MILLIAMPS")) {
      if (currentPin < 0) server.send(400, "text/plain", "NOT_INITIALIZED");
      else server.send(200, "text/plain", String(readCurrentAmps() * 1000.0f));
      return;
    }

    if (cmd.startsWith("CURRENT_READ_AMPS")) {
      if (currentPin < 0) server.send(400, "text/plain", "NOT_INITIALIZED");
      else server.send(200, "text/plain", String(readCurrentAmps()));
      return;
    }

    if (cmd.startsWith("CURRENT_READ_RAW")) {
      if (currentPin < 0) server.send(400, "text/plain", "NOT_INITIALIZED");
      else server.send(200, "text/plain", String(analogRead(currentPin)));
      return;
    }

    if (cmd.startsWith("CURRENT_READ")) {
      char pinText[12];
      if (sscanf(cmd.c_str(), "CURRENT_READ %11s", pinText) == 1) {
        server.send(200, "text/plain", String(analogRead(parseWifiPin(pinText))));
      } else if (currentPin >= 0) {
        server.send(200, "text/plain", String(analogRead(currentPin)));
      } else {
        server.send(400, "text/plain", "INVALID_FORMAT");
      }
      return;
    }

    // ================= STEPPER INIT =================
    if (cmd.startsWith("STEPPER_INIT")) {
      int dirPin, stepPin, steps;
      if (sscanf(cmd.c_str(), "STEPPER_INIT %d %d %d", &dirPin, &stepPin, &steps) == 3) {
        stepperDirPin = dirPin;
        stepperStepPin = stepPin;
        stepperStepsPerRev = (steps > 0) ? steps : 200;
        pinMode(stepperDirPin, OUTPUT);
        pinMode(stepperStepPin, OUTPUT);
        digitalWrite(stepperDirPin, LOW);
        digitalWrite(stepperStepPin, LOW);
        stepperInitialized = true;
        server.send(200, "text/plain", "OK");
      } else {
        server.send(400, "text/plain", "INVALID_FORMAT");
      }
      return;
    }

    // ================= STEPPER ROTATE =================
    if (cmd.startsWith("STEPPER_ROTATE")) {
      char dirStr[10];
      int speedUs, steps;
      if (sscanf(cmd.c_str(), "STEPPER_ROTATE %s %d %d", dirStr, &speedUs, &steps) == 3 && stepperInitialized) {
        int dirVal = (strcmp(dirStr, "HIGH") == 0) ? HIGH : LOW;
        digitalWrite(stepperDirPin, dirVal);
        if (speedUs <= 0) speedUs = 1000;
        for (int i = 0; i < steps; i++) {
          digitalWrite(stepperStepPin, HIGH);
          delayMicroseconds(speedUs);
          digitalWrite(stepperStepPin, LOW);
          delayMicroseconds(speedUs);
        }
        server.send(200, "text/plain", "OK");
      } else {
        server.send(400, "text/plain", "NOT_INITIALIZED");
      }
      return;
    }

    // ================= UNKNOWN COMMAND =================
    server.send(400, "text/plain", "UNKNOWN");
  });

  server.begin();
  Serial.println("HTTP Server Started");
}


void repeat();

void setup() {

Serial.begin(115200);
delay(500);

OTA.setWiFi(DEFAULT_SSID, DEFAULT_PASS);   // OTA uses the same default WiFi
OTA.onOtaMode(stopBlockzie);
OTA.begin("Blockzie");

loadWiFiCredentials();
initializeWiFi();
}

void loop() {
  OTA.loop();          // must stay the first line of loop()
  repeat();
}

void repeat() {

server.handleClient();
{
  static unsigned long lastWifiTry = 0;
  static wl_status_t lastWifiSt = WL_IDLE_STATUS;
  wl_status_t st = WiFi.status();
  if (st != lastWifiSt) {
    lastWifiSt = st;
    if (st == WL_CONNECTED) {
      IPAddress ip = WiFi.localIP();
      Serial.println("Connected to WiFi");
      Serial.print("IP ");
      Serial.print((int)ip[0]);
      Serial.print(".");
      Serial.print((int)ip[1]);
      Serial.print(".");
      Serial.print((int)ip[2]);
      Serial.print(".");
      Serial.println((int)ip[3]);
      Serial.println("HTTP Server Started");
    }
  }
  if (st != WL_CONNECTED && (millis() - lastWifiTry) > 8000UL) {
    lastWifiTry = millis();
    Serial.println("WiFi reconnecting...");
    WiFi.begin(ssid, password);
  }
}
}
